## CMakeLists.txt
```
# SPDX-License-Identifier: MIT

cmake_minimum_required(VERSION 3.20.0)
find_package(Zephyr REQUIRED HINTS $ENV{ZEPHYR_BASE})
project(firmwareguard)

target_sources(app PRIVATE src/main.c src/arbiter_model.c)
```

## sample.yaml
```
sample:
  name: arbiter Firmware Integrity Guard
  description: >
    Embedded AV/integrity engine. Boot-time hash/signature/rollback
    checks, runtime code region monitoring, stack canary checks,
    OTA update validation, and threat scoring. Uses strict safety profile.
common:
  tags: arbiter reasoning security firmware integrity av boot
  platform_allow: native_sim
tests:
  sample.arbiter.firmware-guard:
    tags: arbiter sample
    platform_allow: native_sim
    build_only: true
```

## prj.conf
```kconfig
CONFIG_ZPROJ=y
CONFIG_ZPROJ_TRACE=y
CONFIG_LOG=y
CONFIG_PRINTK=y
```

## src/main.c
```c
/* SPDX-License-Identifier: MIT */
#include <zephyr/kernel.h>
#include <zephyr/logging/log.h>
#include <arbiter/arbiter.h>

LOG_MODULE_REGISTER(firmwareguard, LOG_LEVEL_INF);

extern const struct ARBITER_model ARBITER_generated_model;
static struct ARBITER_ctx ctx;

int main(void)
{
LOG_INF("=== arbiter firmware guard ===");
int ret = ARBITER_init(&ctx, &ARBITER_generated_model);
if (ret != ARBITER_OK) {
LOG_ERR("Init failed: %d", ret);
return ret;
}
LOG_INF("Model: %s  Facts: %u  Rules: %u",
ARBITER_generated_model.name,
ARBITER_generated_model.fact_count,
ARBITER_generated_model.rule_count);
return 0;
}
```

## src/arbiter_model.c
```c
/* SPDX-License-Identifier: MIT */
/* AUTO-GENERATED by arbiterc — do not edit */

#include "arbiter_model.h"
#include <arbiter/arbiter.h>

static const struct ARBITER_fact_def model_facts[] = {
	{ .id = 0, .type = ARBITER_FACT_BOOL, .range_min = 0, .range_max = 0, .default_value = 0, .stale_after_ms = 0, .safety_relevant = true, .name = "boot.image_hash_valid" },
	{ .id = 1, .type = ARBITER_FACT_BOOL, .range_min = 0, .range_max = 0, .default_value = 0, .stale_after_ms = 0, .safety_relevant = true, .name = "boot.rollback_protected" },
	{ .id = 2, .type = ARBITER_FACT_BOOL, .range_min = 0, .range_max = 0, .default_value = 0, .stale_after_ms = 0, .safety_relevant = true, .name = "boot.secure_boot_ok" },
	{ .id = 3, .type = ARBITER_FACT_BOOL, .range_min = 0, .range_max = 0, .default_value = 0, .stale_after_ms = 0, .safety_relevant = true, .name = "boot.signature_valid" },
	{ .id = 4, .type = ARBITER_FACT_UINT32, .range_min = 0, .range_max = 100, .default_value = 0, .stale_after_ms = 0, .safety_relevant = false, .name = "fw.threat_score" },
	{ .id = 5, .type = ARBITER_FACT_BOOL, .range_min = 0, .range_max = 0, .default_value = 0, .stale_after_ms = 10000, .safety_relevant = true, .name = "runtime.code_region_intact" },
	{ .id = 6, .type = ARBITER_FACT_BOOL, .range_min = 0, .range_max = 0, .default_value = 0, .stale_after_ms = 0, .safety_relevant = false, .name = "runtime.heap_integrity" },
	{ .id = 7, .type = ARBITER_FACT_BOOL, .range_min = 0, .range_max = 0, .default_value = 0, .stale_after_ms = 0, .safety_relevant = true, .name = "runtime.stack_canary_ok" },
	{ .id = 8, .type = ARBITER_FACT_UINT32, .range_min = 0, .range_max = 2000000000, .default_value = 0, .stale_after_ms = 0, .safety_relevant = false, .name = "runtime.uptime_s" },
	{ .id = 9, .type = ARBITER_FACT_BOOL, .range_min = 0, .range_max = 0, .default_value = 0, .stale_after_ms = 0, .safety_relevant = false, .name = "runtime.watchdog_fed" },
	{ .id = 10, .type = ARBITER_FACT_BOOL, .range_min = 0, .range_max = 0, .default_value = 0, .stale_after_ms = 0, .safety_relevant = false, .name = "update.hash_verified" },
	{ .id = 11, .type = ARBITER_FACT_BOOL, .range_min = 0, .range_max = 0, .default_value = 0, .stale_after_ms = 0, .safety_relevant = false, .name = "update.pending" },
	{ .id = 12, .type = ARBITER_FACT_BOOL, .range_min = 0, .range_max = 0, .default_value = 0, .stale_after_ms = 0, .safety_relevant = false, .name = "update.source_trusted" },
};

static const struct ARBITER_condition_def model_conditions[] = {
	{ .fact_id = 0, .op = ARBITER_OP_EQ, .value = 0, .group = ARBITER_COND_ALL },
	{ .fact_id = 3, .op = ARBITER_OP_EQ, .value = 0, .group = ARBITER_COND_ALL },
	{ .fact_id = 1, .op = ARBITER_OP_EQ, .value = 0, .group = ARBITER_COND_ALL },
	{ .fact_id = 5, .op = ARBITER_OP_EQ, .value = 0, .group = ARBITER_COND_ALL },
	{ .fact_id = 7, .op = ARBITER_OP_EQ, .value = 0, .group = ARBITER_COND_ALL },
	{ .fact_id = 6, .op = ARBITER_OP_EQ, .value = 0, .group = ARBITER_COND_ALL },
	{ .fact_id = 2, .op = ARBITER_OP_EQ, .value = 1, .group = ARBITER_COND_ALL },
	{ .fact_id = 4, .op = ARBITER_OP_GT, .value = 50, .group = ARBITER_COND_ALL },
	{ .fact_id = 11, .op = ARBITER_OP_EQ, .value = 1, .group = ARBITER_COND_ALL },
	{ .fact_id = 12, .op = ARBITER_OP_EQ, .value = 1, .group = ARBITER_COND_ALL },
	{ .fact_id = 10, .op = ARBITER_OP_EQ, .value = 1, .group = ARBITER_COND_ALL },
	{ .fact_id = 11, .op = ARBITER_OP_EQ, .value = 1, .group = ARBITER_COND_ALL },
	{ .fact_id = 12, .op = ARBITER_OP_EQ, .value = 0, .group = ARBITER_COND_ALL },
	{ .fact_id = 2, .op = ARBITER_OP_EQ, .value = 1, .group = ARBITER_COND_ALL },
	{ .fact_id = 5, .op = ARBITER_OP_EQ, .value = 1, .group = ARBITER_COND_ALL },
	{ .fact_id = 7, .op = ARBITER_OP_EQ, .value = 1, .group = ARBITER_COND_ALL },
};

static const struct ARBITER_action_def model_actions[] = {
	{ .id = 0, .type = ARBITER_ACTION_CALLBACK, .target_fact_id = 0, .target_value = 0, .callback = NULL, .must_complete_within_ms = 0, .safe_state_action = false, .name = "approve_update" },
	{ .id = 1, .type = ARBITER_ACTION_CALLBACK, .target_fact_id = 0, .target_value = 0, .callback = NULL, .must_complete_within_ms = 1, .safe_state_action = true, .name = "halt_boot" },
	{ .id = 2, .type = ARBITER_ACTION_CALLBACK, .target_fact_id = 0, .target_value = 0, .callback = NULL, .must_complete_within_ms = 100, .safe_state_action = true, .name = "isolate_and_reboot" },
	{ .id = 3, .type = ARBITER_ACTION_CALLBACK, .target_fact_id = 0, .target_value = 0, .callback = NULL, .must_complete_within_ms = 0, .safe_state_action = false, .name = "log_threat" },
	{ .id = 4, .type = ARBITER_ACTION_CALLBACK, .target_fact_id = 0, .target_value = 0, .callback = NULL, .must_complete_within_ms = 0, .safe_state_action = false, .name = "reject_update" },
};

static const struct ARBITER_rule_def model_rules[] = {
	{ .id = 0, .rule_class = ARBITER_RULE_SAFETY_GUARD, .condition_start = 0, .condition_count = 1, .action_start = 1, .action_count = 1, .expr_start = 0, .expr_count = 0, .safety_goal_id = UINT16_MAX, .set_mode = 1, .safety_critical = true, .name = "01_boot.hash_fail", .explanation = "Firmware image hash mismatch — tampered binary." },
	{ .id = 1, .rule_class = ARBITER_RULE_SAFETY_GUARD, .condition_start = 1, .condition_count = 1, .action_start = 1, .action_count = 1, .expr_start = 0, .expr_count = 0, .safety_goal_id = UINT16_MAX, .set_mode = 1, .safety_critical = true, .name = "02_boot.signature_fail", .explanation = "Code signature invalid — unsigned or forged firmware." },
	{ .id = 2, .rule_class = ARBITER_RULE_SAFETY_GUARD, .condition_start = 2, .condition_count = 1, .action_start = 1, .action_count = 1, .expr_start = 0, .expr_count = 0, .safety_goal_id = UINT16_MAX, .set_mode = 1, .safety_critical = true, .name = "03_boot.rollback", .explanation = "Anti-rollback check failed — downgrade attempt." },
	{ .id = 3, .rule_class = ARBITER_RULE_SAFETY_GUARD, .condition_start = 3, .condition_count = 1, .action_start = 2, .action_count = 1, .expr_start = 0, .expr_count = 0, .safety_goal_id = UINT16_MAX, .set_mode = 2, .safety_critical = true, .name = "10_runtime.code_tampered", .explanation = "Code region hash mismatch at runtime — quarantine." },
	{ .id = 4, .rule_class = ARBITER_RULE_SAFETY_GUARD, .condition_start = 4, .condition_count = 1, .action_start = 2, .action_count = 1, .expr_start = 0, .expr_count = 0, .safety_goal_id = UINT16_MAX, .set_mode = 2, .safety_critical = true, .name = "11_runtime.stack_smash", .explanation = "Stack canary violation — possible exploit." },
	{ .id = 5, .rule_class = ARBITER_RULE_MODE_GUARD, .condition_start = 5, .condition_count = 1, .action_start = 3, .action_count = 1, .expr_start = 0, .expr_count = 0, .safety_goal_id = UINT16_MAX, .set_mode = 3, .safety_critical = false, .name = "12_runtime.heap_corrupt", .explanation = "Heap integrity check failed — degraded mode." },
	{ .id = 6, .rule_class = ARBITER_RULE_INFERENCE, .condition_start = 6, .condition_count = 1, .action_start = 0, .action_count = 0, .expr_start = 0, .expr_count = 1, .safety_goal_id = UINT16_MAX, .set_mode = UINT16_MAX, .safety_critical = false, .name = "20_threat.score", .explanation = NULL },
	{ .id = 7, .rule_class = ARBITER_RULE_MODE_GUARD, .condition_start = 7, .condition_count = 1, .action_start = 2, .action_count = 1, .expr_start = 1, .expr_count = 0, .safety_goal_id = UINT16_MAX, .set_mode = 2, .safety_critical = false, .name = "21_threat.elevated", .explanation = "Threat score > 50 — quarantine." },
	{ .id = 8, .rule_class = ARBITER_RULE_INFERENCE, .condition_start = 8, .condition_count = 3, .action_start = 0, .action_count = 1, .expr_start = 1, .expr_count = 0, .safety_goal_id = UINT16_MAX, .set_mode = 5, .safety_critical = false, .name = "30_update.check", .explanation = "OTA update: trusted source, hash verified — approve." },
	{ .id = 9, .rule_class = ARBITER_RULE_SAFETY_GUARD, .condition_start = 11, .condition_count = 2, .action_start = 4, .action_count = 1, .expr_start = 1, .expr_count = 0, .safety_goal_id = UINT16_MAX, .set_mode = UINT16_MAX, .safety_critical = true, .name = "31_update.reject", .explanation = "OTA from untrusted source — reject." },
	{ .id = 10, .rule_class = ARBITER_RULE_INFERENCE, .condition_start = 13, .condition_count = 3, .action_start = 0, .action_count = 0, .expr_start = 1, .expr_count = 0, .safety_goal_id = UINT16_MAX, .set_mode = 4, .safety_critical = false, .name = "40_normal", .explanation = NULL },
};

static const struct ARBITER_expr_def model_expressions[] = {
	{ .target_fact_id = 4, .op = ARBITER_EXPR_ASSIGN, .left_fact_id = 65535, .left_literal = 0, .right_fact_id = 65535, .right_literal = 0, .scale = 1 },
};

static const char *model_mode_names[] = {
	"mode.boot_check",
	"mode.integrity_violation",
	"mode.quarantine",
	"mode.running_degraded",
	"mode.running_trusted",
	"mode.update_pending",
};

const struct ARBITER_model ARBITER_generated_model = {
	.name = "firmware_integrity_guard",
	.model_hash = { 0x5b, 0x84, 0xb7, 0xcd, 0x69, 0xf9, 0xb0, 0x86, 0xf9, 0xda, 0x75, 0xdf, 0xc4, 0x83, 0x79, 0x0c, 0x7e, 0xdd, 0x70, 0xbd, 0x5c, 0xd1, 0xf4, 0x10, 0xd9, 0xcf, 0x95, 0x50, 0x06, 0xbd, 0x62, 0x6d },
	.schema_hash = { 0x0d, 0x55, 0x33, 0x65, 0xf3, 0x4e, 0x02, 0xf3, 0xf8, 0x94, 0xe8, 0x25, 0xbb, 0x47, 0x86, 0x45, 0xfd, 0x8b, 0x78, 0xb1, 0x27, 0xf5, 0x8c, 0x42, 0xba, 0xbd, 0x80, 0x1f, 0x77, 0x57, 0x1f, 0x35 },
	.fact_count = 13,
	.rule_count = 11,
	.condition_count = 16,
	.action_count = 5,
	.expr_count = 1,
	.mode_count = 6,
	.facts = model_facts,
	.rules = model_rules,
	.conditions = model_conditions,
	.actions = model_actions,
	.expressions = model_expressions,
	.mode_names = model_mode_names,
};
```

## src/arbiter_model.h
```c
/* SPDX-License-Identifier: MIT */
/* AUTO-GENERATED by arbiterc — do not edit */

#pragma once

#include <stdint.h>
#include <stddef.h>
#include <arbiter/arbiter_model.h>

#define ARBITER_MODEL_NAME "firmware_integrity_guard"
#define ARBITER_MODEL_HASH "5b84b7cd69f9b086f9da75dfc483790c7edd70bd5cd1f410d9cf955006bd626d"
#define ARBITER_MODEL_FACT_COUNT 13u
#define ARBITER_MODEL_RULE_COUNT 11u
#define ARBITER_MODEL_CONDITION_COUNT 16u
#define ARBITER_MODEL_ACTION_COUNT 5u
#define ARBITER_MODEL_MAX_FACTS 13u
#define ARBITER_MODEL_MAX_RULES 11u
#define ARBITER_MODEL_MAX_CONDITIONS 16u
#define ARBITER_MODEL_MAX_ACTIONS 5u
#define ARBITER_MODEL_WCET_OP_COUNT 27u
#define ARBITER_MODEL_TRACE_CAPACITY 11u

extern const struct ARBITER_model ARBITER_generated_model;

#define ARBITER_FACT_BOOT_IMAGE_HASH_VALID 0u
#define ARBITER_FACT_BOOT_ROLLBACK_PROTECTED 1u
#define ARBITER_FACT_BOOT_SECURE_BOOT_OK 2u
#define ARBITER_FACT_BOOT_SIGNATURE_VALID 3u
#define ARBITER_FACT_FW_THREAT_SCORE 4u
#define ARBITER_FACT_RUNTIME_CODE_REGION_INTACT 5u
#define ARBITER_FACT_RUNTIME_HEAP_INTEGRITY 6u
#define ARBITER_FACT_RUNTIME_STACK_CANARY_OK 7u
#define ARBITER_FACT_RUNTIME_UPTIME_S 8u
#define ARBITER_FACT_RUNTIME_WATCHDOG_FED 9u
#define ARBITER_FACT_UPDATE_HASH_VERIFIED 10u
#define ARBITER_FACT_UPDATE_PENDING 11u
#define ARBITER_FACT_UPDATE_SOURCE_TRUSTED 12u

#define ARBITER_MODE_MODE_BOOT_CHECK 0u
#define ARBITER_MODE_MODE_INTEGRITY_VIOLATION 1u
#define ARBITER_MODE_MODE_QUARANTINE 2u
#define ARBITER_MODE_MODE_RUNNING_DEGRADED 3u
#define ARBITER_MODE_MODE_RUNNING_TRUSTED 4u
#define ARBITER_MODE_MODE_UPDATE_PENDING 5u
```
