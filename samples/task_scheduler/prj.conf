## CMakeLists.txt
```
# SPDX-License-Identifier: MIT

cmake_minimum_required(VERSION 3.20.0)
find_package(Zephyr REQUIRED HINTS $ENV{ZEPHYR_BASE})
project(task_scheduler)

target_sources(app PRIVATE src/main.c src/arbiter_model.c)
```

## sample.yaml
```
sample:
  name: arbiter Task Scheduler Solver
  description: >
    Priority-and-deadline-aware task scheduler implemented as a ARB
    reasoning model.  Computes urgency scores combining static priority
    with deadline proximity, selects the best ready task, and detects
    deadline misses — demonstrating embedded scheduling as a solver.
common:
  tags: arbiter solver scheduler deadline priority real-time
  platform_allow: native_sim
tests:
  sample.arbiter.task-scheduler:
    tags: arbiter sample solver
    platform_allow: native_sim
    build_only: true
```

## prj.conf
```kconfig
CONFIG_ZPROJ=y
CONFIG_ZPROJ_TRACE=y
CONFIG_LOG=y
CONFIG_PRINTK=y
```

## src/main.c
```c
/* SPDX-License-Identifier: MIT */

/**
 * Task Scheduler Solver Sample
 *
 * arbiter reasons about 4 task slots, computing urgency scores from
 * priority and deadline proximity.  The engine selects the highest-
 * urgency ready task and detects deadline misses.
 */

#include <zephyr/kernel.h>
#include <zephyr/logging/log.h>
#include <arbiter/arbiter.h>

LOG_MODULE_REGISTER(task_sched, LOG_LEVEL_INF);

extern const struct ARBITER_model ARBITER_generated_model;

static struct ARBITER_ctx ctx;

/* Fact indices (canonical order) */
enum {
	F_TICK = 0,
	F_ENABLE,
	F_BEST_URGENCY,
	F_SELECTED,
	/* task0 block */
	F_T0_READY, F_T0_PRIO, F_T0_DEADLINE, F_T0_SLACK, F_T0_URGENCY,
	/* task1 block */
	F_T1_READY, F_T1_PRIO, F_T1_DEADLINE, F_T1_SLACK, F_T1_URGENCY,
	/* task2 block */
	F_T2_READY, F_T2_PRIO, F_T2_DEADLINE, F_T2_SLACK, F_T2_URGENCY,
	/* task3 block */
	F_T3_READY, F_T3_PRIO, F_T3_DEADLINE, F_T3_SLACK, F_T3_URGENCY,
};

static const char *task_names[] = {"sensor_read", "log_flush",
				   "comms_tx", "watchdog_kick"};

void app_dispatch_task(void)
{
	int32_t sel = ctx.fact_values[F_SELECTED].value;

	if (sel >= 0 && sel <= 3) {
		LOG_INF("  >> DISPATCH: %s (urgency=%d)",
			task_names[sel],
			ctx.fact_values[F_BEST_URGENCY].value);
	}
}

void app_report_deadline_miss(void)
{
	LOG_WRN("  !! DEADLINE MISS detected");
}

int main(void)
{
	LOG_INF("=== arbiter Task Scheduler Solver ===");

	int ret = ARBITER_init(&ctx, &ARBITER_generated_model);

	if (ret != ARBITER_OK) {
		LOG_ERR("Init failed: %d", ret);
		return ret;
	}

	ARBITER_set_bool(&ctx, F_ENABLE, true);

	/* Configure 4 tasks with varying priorities and deadlines */
	/* Task 0: sensor_read — high priority, tight deadline */
	ARBITER_set_bool(&ctx, F_T0_READY, true);
	ARBITER_set_i32(&ctx, F_T0_PRIO, 90);
	ARBITER_set_u32(&ctx, F_T0_DEADLINE, 500);

	/* Task 1: log_flush — low priority, relaxed deadline */
	ARBITER_set_bool(&ctx, F_T1_READY, true);
	ARBITER_set_i32(&ctx, F_T1_PRIO, 20);
	ARBITER_set_u32(&ctx, F_T1_DEADLINE, 5000);

	/* Task 2: comms_tx — medium priority, medium deadline */
	ARBITER_set_bool(&ctx, F_T2_READY, true);
	ARBITER_set_i32(&ctx, F_T2_PRIO, 60);
	ARBITER_set_u32(&ctx, F_T2_DEADLINE, 1000);

	/* Task 3: watchdog_kick — critical priority, short deadline */
	ARBITER_set_bool(&ctx, F_T3_READY, true);
	ARBITER_set_i32(&ctx, F_T3_PRIO, 99);
	ARBITER_set_u32(&ctx, F_T3_DEADLINE, 200);

	for (uint32_t tick = 0; tick < 600; tick += 50) {
		ARBITER_set_u32(&ctx, F_TICK, tick);

		struct ARBITER_snapshot snap;
		struct ARBITER_result result;

		ARBITER_snapshot_begin(&ctx, &snap);
		ARBITER_eval(&ARBITER_generated_model, &snap, &result, NULL);

		LOG_INF("tick=%u  selected=%d  urgency=%d",
			tick,
			ctx.fact_values[F_SELECTED].value,
			ctx.fact_values[F_BEST_URGENCY].value);

		k_sleep(K_MSEC(10));
	}

	return 0;
}
```

## src/arbiter_model.c
```c
/* SPDX-License-Identifier: MIT */
/* AUTO-GENERATED by arbiterc — do not edit */

#include "arbiter_model.h"
#include <arbiter/arbiter.h>

static const struct ARBITER_fact_def model_facts[] = {
	{ .id = 0, .type = ARBITER_FACT_BOOL, .range_min = 0, .range_max = 0, .default_value = 0, .stale_after_ms = 0, .safety_relevant = false, .name = "in.enable" },
	{ .id = 1, .type = ARBITER_FACT_UINT32, .range_min = 0, .range_max = 0, .default_value = 0, .stale_after_ms = 0, .safety_relevant = false, .name = "in.tick" },
	{ .id = 2, .type = ARBITER_FACT_INT32, .range_min = 0, .range_max = 0, .default_value = 0, .stale_after_ms = 0, .safety_relevant = false, .name = "sched.best_urgency" },
	{ .id = 3, .type = ARBITER_FACT_INT32, .range_min = -1, .range_max = 3, .default_value = -1, .stale_after_ms = 0, .safety_relevant = false, .name = "sched.selected" },
	{ .id = 4, .type = ARBITER_FACT_UINT32, .range_min = 0, .range_max = 0, .default_value = 0, .stale_after_ms = 0, .safety_relevant = false, .name = "task0.deadline" },
	{ .id = 5, .type = ARBITER_FACT_INT32, .range_min = 0, .range_max = 100, .default_value = 0, .stale_after_ms = 0, .safety_relevant = false, .name = "task0.priority" },
	{ .id = 6, .type = ARBITER_FACT_BOOL, .range_min = 0, .range_max = 0, .default_value = 0, .stale_after_ms = 0, .safety_relevant = false, .name = "task0.ready" },
	{ .id = 7, .type = ARBITER_FACT_INT32, .range_min = 0, .range_max = 0, .default_value = 0, .stale_after_ms = 0, .safety_relevant = false, .name = "task0.slack" },
	{ .id = 8, .type = ARBITER_FACT_INT32, .range_min = 0, .range_max = 0, .default_value = 0, .stale_after_ms = 0, .safety_relevant = false, .name = "task0.urgency" },
	{ .id = 9, .type = ARBITER_FACT_UINT32, .range_min = 0, .range_max = 0, .default_value = 0, .stale_after_ms = 0, .safety_relevant = false, .name = "task1.deadline" },
	{ .id = 10, .type = ARBITER_FACT_INT32, .range_min = 0, .range_max = 100, .default_value = 0, .stale_after_ms = 0, .safety_relevant = false, .name = "task1.priority" },
	{ .id = 11, .type = ARBITER_FACT_BOOL, .range_min = 0, .range_max = 0, .default_value = 0, .stale_after_ms = 0, .safety_relevant = false, .name = "task1.ready" },
	{ .id = 12, .type = ARBITER_FACT_INT32, .range_min = 0, .range_max = 0, .default_value = 0, .stale_after_ms = 0, .safety_relevant = false, .name = "task1.slack" },
	{ .id = 13, .type = ARBITER_FACT_INT32, .range_min = 0, .range_max = 0, .default_value = 0, .stale_after_ms = 0, .safety_relevant = false, .name = "task1.urgency" },
	{ .id = 14, .type = ARBITER_FACT_UINT32, .range_min = 0, .range_max = 0, .default_value = 0, .stale_after_ms = 0, .safety_relevant = false, .name = "task2.deadline" },
	{ .id = 15, .type = ARBITER_FACT_INT32, .range_min = 0, .range_max = 100, .default_value = 0, .stale_after_ms = 0, .safety_relevant = false, .name = "task2.priority" },
	{ .id = 16, .type = ARBITER_FACT_BOOL, .range_min = 0, .range_max = 0, .default_value = 0, .stale_after_ms = 0, .safety_relevant = false, .name = "task2.ready" },
	{ .id = 17, .type = ARBITER_FACT_INT32, .range_min = 0, .range_max = 0, .default_value = 0, .stale_after_ms = 0, .safety_relevant = false, .name = "task2.slack" },
	{ .id = 18, .type = ARBITER_FACT_INT32, .range_min = 0, .range_max = 0, .default_value = 0, .stale_after_ms = 0, .safety_relevant = false, .name = "task2.urgency" },
	{ .id = 19, .type = ARBITER_FACT_UINT32, .range_min = 0, .range_max = 0, .default_value = 0, .stale_after_ms = 0, .safety_relevant = false, .name = "task3.deadline" },
	{ .id = 20, .type = ARBITER_FACT_INT32, .range_min = 0, .range_max = 100, .default_value = 0, .stale_after_ms = 0, .safety_relevant = false, .name = "task3.priority" },
	{ .id = 21, .type = ARBITER_FACT_BOOL, .range_min = 0, .range_max = 0, .default_value = 0, .stale_after_ms = 0, .safety_relevant = false, .name = "task3.ready" },
	{ .id = 22, .type = ARBITER_FACT_INT32, .range_min = 0, .range_max = 0, .default_value = 0, .stale_after_ms = 0, .safety_relevant = false, .name = "task3.slack" },
	{ .id = 23, .type = ARBITER_FACT_INT32, .range_min = 0, .range_max = 0, .default_value = 0, .stale_after_ms = 0, .safety_relevant = false, .name = "task3.urgency" },
};

static const struct ARBITER_condition_def model_conditions[] = {
	{ .fact_id = 0, .op = ARBITER_OP_EQ, .value = 0, .group = ARBITER_COND_ALL },
	{ .fact_id = 0, .op = ARBITER_OP_EQ, .value = 1, .group = ARBITER_COND_ALL },
	{ .fact_id = 6, .op = ARBITER_OP_EQ, .value = 1, .group = ARBITER_COND_ALL },
	{ .fact_id = 0, .op = ARBITER_OP_EQ, .value = 1, .group = ARBITER_COND_ALL },
	{ .fact_id = 11, .op = ARBITER_OP_EQ, .value = 1, .group = ARBITER_COND_ALL },
	{ .fact_id = 0, .op = ARBITER_OP_EQ, .value = 1, .group = ARBITER_COND_ALL },
	{ .fact_id = 16, .op = ARBITER_OP_EQ, .value = 1, .group = ARBITER_COND_ALL },
	{ .fact_id = 0, .op = ARBITER_OP_EQ, .value = 1, .group = ARBITER_COND_ALL },
	{ .fact_id = 21, .op = ARBITER_OP_EQ, .value = 1, .group = ARBITER_COND_ALL },
	{ .fact_id = 0, .op = ARBITER_OP_EQ, .value = 1, .group = ARBITER_COND_ALL },
	{ .fact_id = 0, .op = ARBITER_OP_EQ, .value = 1, .group = ARBITER_COND_ALL },
	{ .fact_id = 3, .op = ARBITER_OP_GE, .value = 0, .group = ARBITER_COND_ALL },
	{ .fact_id = 7, .op = ARBITER_OP_LE, .value = 0, .group = ARBITER_COND_ANY },
	{ .fact_id = 12, .op = ARBITER_OP_LE, .value = 0, .group = ARBITER_COND_ANY },
	{ .fact_id = 17, .op = ARBITER_OP_LE, .value = 0, .group = ARBITER_COND_ANY },
	{ .fact_id = 22, .op = ARBITER_OP_LE, .value = 0, .group = ARBITER_COND_ANY },
};

static const struct ARBITER_action_def model_actions[] = {
	{ .id = 0, .type = ARBITER_ACTION_CALLBACK, .target_fact_id = 0, .target_value = 0, .callback = NULL, .must_complete_within_ms = 0, .safe_state_action = false, .name = "dispatch_task" },
	{ .id = 1, .type = ARBITER_ACTION_CALLBACK, .target_fact_id = 0, .target_value = 0, .callback = NULL, .must_complete_within_ms = 0, .safe_state_action = false, .name = "report_deadline_miss" },
};

static const struct ARBITER_rule_def model_rules[] = {
	{ .id = 0, .rule_class = ARBITER_RULE_MODE_GUARD, .condition_start = 0, .condition_count = 1, .action_start = 0, .action_count = 0, .expr_start = 0, .expr_count = 1, .safety_goal_id = UINT16_MAX, .set_mode = 2, .safety_critical = false, .name = "01_idle", .explanation = NULL },
	{ .id = 1, .rule_class = ARBITER_RULE_INFERENCE, .condition_start = 1, .condition_count = 2, .action_start = 0, .action_count = 0, .expr_start = 1, .expr_count = 4, .safety_goal_id = UINT16_MAX, .set_mode = UINT16_MAX, .safety_critical = false, .name = "10_urgency.task0", .explanation = NULL },
	{ .id = 2, .rule_class = ARBITER_RULE_INFERENCE, .condition_start = 3, .condition_count = 2, .action_start = 0, .action_count = 0, .expr_start = 5, .expr_count = 4, .safety_goal_id = UINT16_MAX, .set_mode = UINT16_MAX, .safety_critical = false, .name = "11_urgency.task1", .explanation = NULL },
	{ .id = 3, .rule_class = ARBITER_RULE_INFERENCE, .condition_start = 5, .condition_count = 2, .action_start = 0, .action_count = 0, .expr_start = 9, .expr_count = 4, .safety_goal_id = UINT16_MAX, .set_mode = UINT16_MAX, .safety_critical = false, .name = "12_urgency.task2", .explanation = NULL },
	{ .id = 4, .rule_class = ARBITER_RULE_INFERENCE, .condition_start = 7, .condition_count = 2, .action_start = 0, .action_count = 0, .expr_start = 13, .expr_count = 4, .safety_goal_id = UINT16_MAX, .set_mode = UINT16_MAX, .safety_critical = false, .name = "13_urgency.task3", .explanation = NULL },
	{ .id = 5, .rule_class = ARBITER_RULE_INFERENCE, .condition_start = 9, .condition_count = 1, .action_start = 0, .action_count = 0, .expr_start = 17, .expr_count = 6, .safety_goal_id = UINT16_MAX, .set_mode = 1, .safety_critical = false, .name = "20_select", .explanation = "Select task with highest urgency score." },
	{ .id = 6, .rule_class = ARBITER_RULE_OBLIGATION, .condition_start = 10, .condition_count = 2, .action_start = 0, .action_count = 1, .expr_start = 23, .expr_count = 0, .safety_goal_id = UINT16_MAX, .set_mode = UINT16_MAX, .safety_critical = false, .name = "30_dispatch", .explanation = "Dispatch selected task." },
	{ .id = 7, .rule_class = ARBITER_RULE_SAFETY_GUARD, .condition_start = 12, .condition_count = 4, .action_start = 1, .action_count = 1, .expr_start = 23, .expr_count = 0, .safety_goal_id = UINT16_MAX, .set_mode = 0, .safety_critical = true, .name = "40_deadline_miss", .explanation = "At least one task has missed its deadline." },
};

static const struct ARBITER_expr_def model_expressions[] = {
	{ .target_fact_id = 3, .op = ARBITER_EXPR_ASSIGN, .left_fact_id = 65535, .left_literal = -1, .right_fact_id = 65535, .right_literal = 0, .scale = 1 },
	{ .target_fact_id = 7, .op = ARBITER_EXPR_SUB, .left_fact_id = 4, .left_literal = 0, .right_fact_id = 1, .right_literal = 0, .scale = 1 },
	{ .target_fact_id = 7, .op = ARBITER_EXPR_CLAMP, .left_fact_id = 7, .left_literal = 0, .right_fact_id = 65535, .right_literal = 0, .scale = 100000 },
	{ .target_fact_id = 8, .op = ARBITER_EXPR_SCALE, .left_fact_id = 5, .left_literal = 0, .right_fact_id = 65535, .right_literal = 100, .scale = 1 },
	{ .target_fact_id = 8, .op = ARBITER_EXPR_SUB, .left_fact_id = 8, .left_literal = 0, .right_fact_id = 7, .right_literal = 0, .scale = 1 },
	{ .target_fact_id = 12, .op = ARBITER_EXPR_SUB, .left_fact_id = 9, .left_literal = 0, .right_fact_id = 1, .right_literal = 0, .scale = 1 },
	{ .target_fact_id = 12, .op = ARBITER_EXPR_CLAMP, .left_fact_id = 12, .left_literal = 0, .right_fact_id = 65535, .right_literal = 0, .scale = 100000 },
	{ .target_fact_id = 13, .op = ARBITER_EXPR_SCALE, .left_fact_id = 10, .left_literal = 0, .right_fact_id = 65535, .right_literal = 100, .scale = 1 },
	{ .target_fact_id = 13, .op = ARBITER_EXPR_SUB, .left_fact_id = 13, .left_literal = 0, .right_fact_id = 12, .right_literal = 0, .scale = 1 },
	{ .target_fact_id = 17, .op = ARBITER_EXPR_SUB, .left_fact_id = 14, .left_literal = 0, .right_fact_id = 1, .right_literal = 0, .scale = 1 },
	{ .target_fact_id = 17, .op = ARBITER_EXPR_CLAMP, .left_fact_id = 17, .left_literal = 0, .right_fact_id = 65535, .right_literal = 0, .scale = 100000 },
	{ .target_fact_id = 18, .op = ARBITER_EXPR_SCALE, .left_fact_id = 15, .left_literal = 0, .right_fact_id = 65535, .right_literal = 100, .scale = 1 },
	{ .target_fact_id = 18, .op = ARBITER_EXPR_SUB, .left_fact_id = 18, .left_literal = 0, .right_fact_id = 17, .right_literal = 0, .scale = 1 },
	{ .target_fact_id = 22, .op = ARBITER_EXPR_SUB, .left_fact_id = 19, .left_literal = 0, .right_fact_id = 1, .right_literal = 0, .scale = 1 },
	{ .target_fact_id = 22, .op = ARBITER_EXPR_CLAMP, .left_fact_id = 22, .left_literal = 0, .right_fact_id = 65535, .right_literal = 0, .scale = 100000 },
	{ .target_fact_id = 23, .op = ARBITER_EXPR_SCALE, .left_fact_id = 20, .left_literal = 0, .right_fact_id = 65535, .right_literal = 100, .scale = 1 },
	{ .target_fact_id = 23, .op = ARBITER_EXPR_SUB, .left_fact_id = 23, .left_literal = 0, .right_fact_id = 22, .right_literal = 0, .scale = 1 },
	{ .target_fact_id = 2, .op = ARBITER_EXPR_ASSIGN, .left_fact_id = 65535, .left_literal = -999999, .right_fact_id = 65535, .right_literal = 0, .scale = 1 },
	{ .target_fact_id = 3, .op = ARBITER_EXPR_ASSIGN, .left_fact_id = 65535, .left_literal = -1, .right_fact_id = 65535, .right_literal = 0, .scale = 1 },
	{ .target_fact_id = 2, .op = ARBITER_EXPR_MAX, .left_fact_id = 2, .left_literal = 0, .right_fact_id = 8, .right_literal = 0, .scale = 1 },
	{ .target_fact_id = 2, .op = ARBITER_EXPR_MAX, .left_fact_id = 2, .left_literal = 0, .right_fact_id = 13, .right_literal = 0, .scale = 1 },
	{ .target_fact_id = 2, .op = ARBITER_EXPR_MAX, .left_fact_id = 2, .left_literal = 0, .right_fact_id = 18, .right_literal = 0, .scale = 1 },
	{ .target_fact_id = 2, .op = ARBITER_EXPR_MAX, .left_fact_id = 2, .left_literal = 0, .right_fact_id = 23, .right_literal = 0, .scale = 1 },
};

static const char *model_mode_names[] = {
	"mode.deadline_miss",
	"mode.dispatching",
	"mode.idle",
};

const struct ARBITER_model ARBITER_generated_model = {
	.name = "task_scheduler",
	.model_hash = { 0x63, 0xd6, 0x0d, 0xce, 0x5d, 0x6f, 0xeb, 0x03, 0xd1, 0x4b, 0xee, 0xb7, 0x72, 0x11, 0xa8, 0xd3, 0xb7, 0xad, 0x03, 0x7f, 0xbc, 0x3b, 0xf2, 0x54, 0x8e, 0x1d, 0x74, 0x9c, 0xe9, 0xa8, 0x50, 0x13 },
	.schema_hash = { 0x0d, 0x55, 0x33, 0x65, 0xf3, 0x4e, 0x02, 0xf3, 0xf8, 0x94, 0xe8, 0x25, 0xbb, 0x47, 0x86, 0x45, 0xfd, 0x8b, 0x78, 0xb1, 0x27, 0xf5, 0x8c, 0x42, 0xba, 0xbd, 0x80, 0x1f, 0x77, 0x57, 0x1f, 0x35 },
	.fact_count = 24,
	.rule_count = 8,
	.condition_count = 16,
	.action_count = 2,
	.expr_count = 23,
	.mode_count = 3,
	.facts = model_facts,
	.rules = model_rules,
	.conditions = model_conditions,
	.actions = model_actions,
	.expressions = model_expressions,
	.mode_names = model_mode_names,
};
```

## src/arbiter_model.h
```c
/* SPDX-License-Identifier: MIT */
/* AUTO-GENERATED by arbiterc — do not edit */

#pragma once

#include <stdint.h>
#include <stddef.h>
#include <arbiter/arbiter_model.h>

#define ARBITER_MODEL_NAME "task_scheduler"
#define ARBITER_MODEL_HASH "63d60dce5d6feb03d14beeb77211a8d3b7ad037fbc3bf2548e1d749ce9a85013"
#define ARBITER_MODEL_FACT_COUNT 24u
#define ARBITER_MODEL_RULE_COUNT 8u
#define ARBITER_MODEL_CONDITION_COUNT 16u
#define ARBITER_MODEL_ACTION_COUNT 2u
#define ARBITER_MODEL_MAX_FACTS 24u
#define ARBITER_MODEL_MAX_RULES 8u
#define ARBITER_MODEL_MAX_CONDITIONS 16u
#define ARBITER_MODEL_MAX_ACTIONS 2u
#define ARBITER_MODEL_WCET_OP_COUNT 24u
#define ARBITER_MODEL_TRACE_CAPACITY 8u

extern const struct ARBITER_model ARBITER_generated_model;

#define ARBITER_FACT_IN_ENABLE 0u
#define ARBITER_FACT_IN_TICK 1u
#define ARBITER_FACT_SCHED_BEST_URGENCY 2u
#define ARBITER_FACT_SCHED_SELECTED 3u
#define ARBITER_FACT_TASK0_DEADLINE 4u
#define ARBITER_FACT_TASK0_PRIORITY 5u
#define ARBITER_FACT_TASK0_READY 6u
#define ARBITER_FACT_TASK0_SLACK 7u
#define ARBITER_FACT_TASK0_URGENCY 8u
#define ARBITER_FACT_TASK1_DEADLINE 9u
#define ARBITER_FACT_TASK1_PRIORITY 10u
#define ARBITER_FACT_TASK1_READY 11u
#define ARBITER_FACT_TASK1_SLACK 12u
#define ARBITER_FACT_TASK1_URGENCY 13u
#define ARBITER_FACT_TASK2_DEADLINE 14u
#define ARBITER_FACT_TASK2_PRIORITY 15u
#define ARBITER_FACT_TASK2_READY 16u
#define ARBITER_FACT_TASK2_SLACK 17u
#define ARBITER_FACT_TASK2_URGENCY 18u
#define ARBITER_FACT_TASK3_DEADLINE 19u
#define ARBITER_FACT_TASK3_PRIORITY 20u
#define ARBITER_FACT_TASK3_READY 21u
#define ARBITER_FACT_TASK3_SLACK 22u
#define ARBITER_FACT_TASK3_URGENCY 23u

#define ARBITER_MODE_MODE_DEADLINE_MISS 0u
#define ARBITER_MODE_MODE_DISPATCHING 1u
#define ARBITER_MODE_MODE_IDLE 2u
```
