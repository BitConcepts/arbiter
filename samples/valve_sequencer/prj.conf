## CMakeLists.txt
```
# SPDX-License-Identifier: MIT

cmake_minimum_required(VERSION 3.20.0)
find_package(Zephyr REQUIRED HINTS $ENV{ZEPHYR_BASE})
project(valve_sequencer)

target_sources(app PRIVATE src/main.c src/arbiter_model.c)
```

## sample.yaml
```
sample:
  name: arbiter Valve Sequencer
  description: >
    Multi-step batch process sequencer. arbiter reasons through
    fill -> reagent -> react -> drain -> vent, managing step state
    as a derived fact and enforcing safety interlocks (overpressure,
    overtemp, operator abort) at every step.
common:
  tags: arbiter reasoning sequencer valve process-control batch
  platform_allow: native_sim
tests:
  sample.arbiter.valve-sequencer:
    tags: arbiter sample
    platform_allow: native_sim
    build_only: true
```

## prj.conf
```kconfig
CONFIG_ARBITER=y
CONFIG_ARBITER_TRACE=y
CONFIG_LOG=y
CONFIG_PRINTK=y
```

## src/main.c
```c
/* SPDX-License-Identifier: MIT */

/**
 * Valve Sequencer — Process Reasoning Engine
 *
 * arbiter reasons through a multi-step batch process:
 *   idle -> fill -> add reagent -> react (timed hold) -> drain -> vent -> complete
 *
 * Each step transition is a reasoning rule with conditions on sensor
 * values and computed state. Safety guards for overpressure, overtemp,
 * and operator abort override at any point.
 *
 * This demonstrates arbiter as a stateful sequencer — it manages
 * proc.step as a derived fact, advancing the process through logic.
 */

#include <zephyr/kernel.h>
#include <zephyr/logging/log.h>
#include <arbiter/arbiter.h>

LOG_MODULE_REGISTER(valve_seq, LOG_LEVEL_INF);

extern const struct ARBITER_model ARBITER_generated_model;
static struct ARBITER_ctx ctx;

/* Callbacks */
void app_emergency_vent(void)         { LOG_WRN("SAFETY: Emergency vent!"); }
void app_emergency_cool(void)         { LOG_WRN("SAFETY: Emergency cooling!"); }
void app_close_all_valves(void)       { LOG_INF("VALVES: All closed"); }
void app_open_inlet(void)             { LOG_INF("VALVES: Inlet OPEN"); }
void app_close_inlet_open_reagent(void) { LOG_INF("VALVES: Inlet CLOSE, Reagent OPEN"); }
void app_close_reagent(void)          { LOG_INF("VALVES: Reagent CLOSE"); }
void app_open_outlet(void)            { LOG_INF("VALVES: Outlet OPEN"); }
void app_close_outlet_open_vent(void) { LOG_INF("VALVES: Outlet CLOSE, Vent OPEN"); }

int main(void)
{
	LOG_INF("=== arbiter Valve Sequencer Demo ===");

	int ret = ARBITER_init(&ctx, &ARBITER_generated_model);

	if (ret != ARBITER_OK) {
		LOG_ERR("Init failed: %d", ret);
		return ret;
	}

	struct ARBITER_snapshot snap;
	struct ARBITER_result result;
	uint16_t mode;

	/* Helper: fact indices (canonical alpha order) */
	/* calc.drain_complete=0, calc.fill_complete=1, calc.reaction_complete=2,
	 * proc.abort_cmd=3, proc.start_cmd=4, proc.step=5, proc.step_timer_ms=6,
	 * sensor.level_pct=7, sensor.pressure_kpa=8, sensor.temp_c=9,
	 * valve.inlet=10, valve.outlet=11, valve.reagent=12, valve.vent=13
	 */

	#define F_FILL_COMPLETE   1
	#define F_REACT_COMPLETE  2
	#define F_ABORT           3
	#define F_START           4
	#define F_STEP            5
	#define F_TIMER           6
	#define F_LEVEL           7
	#define F_PRESSURE        8
	#define F_TEMP            9

	/* Safe starting conditions */
	ARBITER_set_u32(&ctx, F_PRESSURE, 1010);  /* ~101 kPa (atmospheric) */
	ARBITER_set_i32(&ctx, F_TEMP, 250);       /* 25 °C */
	ARBITER_set_bool(&ctx, F_ABORT, false);

	LOG_INF("--- Start sequence ---");
	ARBITER_set_bool(&ctx, F_START, true);
	ARBITER_set_u32(&ctx, F_LEVEL, 0);
	ARBITER_snapshot_begin(&ctx, &snap);
	ARBITER_eval(&ARBITER_generated_model, &snap, &result, NULL);
	ARBITER_get_mode(&result, &mode);
	LOG_INF("  Step: %d  Mode: %u", ctx.fact_values[F_STEP].value, mode);

	LOG_INF("--- Fill to 85%% ---");
	ARBITER_set_u32(&ctx, F_LEVEL, 85);
	ARBITER_snapshot_begin(&ctx, &snap);
	ARBITER_eval(&ARBITER_generated_model, &snap, &result, NULL);
	ARBITER_get_mode(&result, &mode);
	LOG_INF("  Step: %d  Mode: %u", ctx.fact_values[F_STEP].value, mode);

	LOG_INF("--- Reagent fills to 92%% ---");
	ARBITER_set_u32(&ctx, F_LEVEL, 92);
	ARBITER_snapshot_begin(&ctx, &snap);
	ARBITER_eval(&ARBITER_generated_model, &snap, &result, NULL);
	ARBITER_get_mode(&result, &mode);
	LOG_INF("  Step: %d  Mode: %u", ctx.fact_values[F_STEP].value, mode);

	LOG_INF("--- Reaction timer > 30s ---");
	ARBITER_set_u32(&ctx, F_TIMER, 35000);
	ARBITER_snapshot_begin(&ctx, &snap);
	ARBITER_eval(&ARBITER_generated_model, &snap, &result, NULL);
	ARBITER_get_mode(&result, &mode);
	LOG_INF("  Step: %d  Mode: %u", ctx.fact_values[F_STEP].value, mode);

	LOG_INF("--- Drain to 3%% ---");
	ARBITER_set_u32(&ctx, F_LEVEL, 3);
	ARBITER_snapshot_begin(&ctx, &snap);
	ARBITER_eval(&ARBITER_generated_model, &snap, &result, NULL);
	ARBITER_get_mode(&result, &mode);
	LOG_INF("  Step: %d  Mode: %u", ctx.fact_values[F_STEP].value, mode);

	LOG_INF("--- Vent complete (pressure atmospheric) ---");
	ARBITER_set_u32(&ctx, F_PRESSURE, 1000);
	ARBITER_snapshot_begin(&ctx, &snap);
	ARBITER_eval(&ARBITER_generated_model, &snap, &result, NULL);
	ARBITER_get_mode(&result, &mode);
	LOG_INF("  Step: %d  Mode: %u  SEQUENCE COMPLETE", ctx.fact_values[F_STEP].value, mode);

	return 0;
}
```

## src/arbiter_model.c
```c
/* SPDX-License-Identifier: MIT */
/* AUTO-GENERATED by arbiterc — do not edit */

#include "arbiter_model.h"
#include <arbiter/arbiter.h>

static const struct ARBITER_fact_def model_facts[] = {
	{ .id = 0, .type = ARBITER_FACT_BOOL, .range_min = 0, .range_max = 0, .default_value = 0, .stale_after_ms = 0, .safety_relevant = false, .name = "calc.drain_complete" },
	{ .id = 1, .type = ARBITER_FACT_BOOL, .range_min = 0, .range_max = 0, .default_value = 0, .stale_after_ms = 0, .safety_relevant = false, .name = "calc.fill_complete" },
	{ .id = 2, .type = ARBITER_FACT_BOOL, .range_min = 0, .range_max = 0, .default_value = 0, .stale_after_ms = 0, .safety_relevant = false, .name = "calc.reaction_complete" },
	{ .id = 3, .type = ARBITER_FACT_BOOL, .range_min = 0, .range_max = 0, .default_value = 0, .stale_after_ms = 0, .safety_relevant = false, .name = "proc.abort_cmd" },
	{ .id = 4, .type = ARBITER_FACT_BOOL, .range_min = 0, .range_max = 0, .default_value = 0, .stale_after_ms = 0, .safety_relevant = false, .name = "proc.start_cmd" },
	{ .id = 5, .type = ARBITER_FACT_UINT32, .range_min = 0, .range_max = 10, .default_value = 0, .stale_after_ms = 0, .safety_relevant = false, .name = "proc.step" },
	{ .id = 6, .type = ARBITER_FACT_UINT32, .range_min = 0, .range_max = 600000, .default_value = 0, .stale_after_ms = 0, .safety_relevant = false, .name = "proc.step_timer_ms" },
	{ .id = 7, .type = ARBITER_FACT_UINT32, .range_min = 0, .range_max = 100, .default_value = 0, .stale_after_ms = 2000, .safety_relevant = true, .name = "sensor.level_pct" },
	{ .id = 8, .type = ARBITER_FACT_UINT32, .range_min = 0, .range_max = 20000, .default_value = 0, .stale_after_ms = 1000, .safety_relevant = true, .name = "sensor.pressure_kpa" },
	{ .id = 9, .type = ARBITER_FACT_INT32, .range_min = -500, .range_max = 3000, .default_value = 0, .stale_after_ms = 5000, .safety_relevant = true, .name = "sensor.temp_c" },
	{ .id = 10, .type = ARBITER_FACT_BOOL, .range_min = 0, .range_max = 0, .default_value = 0, .stale_after_ms = 0, .safety_relevant = false, .name = "valve.inlet" },
	{ .id = 11, .type = ARBITER_FACT_BOOL, .range_min = 0, .range_max = 0, .default_value = 0, .stale_after_ms = 0, .safety_relevant = false, .name = "valve.outlet" },
	{ .id = 12, .type = ARBITER_FACT_BOOL, .range_min = 0, .range_max = 0, .default_value = 0, .stale_after_ms = 0, .safety_relevant = false, .name = "valve.reagent" },
	{ .id = 13, .type = ARBITER_FACT_BOOL, .range_min = 0, .range_max = 0, .default_value = 0, .stale_after_ms = 0, .safety_relevant = false, .name = "valve.vent" },
};

static const struct ARBITER_condition_def model_conditions[] = {
	{ .fact_id = 8, .op = ARBITER_OP_GT, .value = 15000, .group = ARBITER_COND_ALL },
	{ .fact_id = 9, .op = ARBITER_OP_GT, .value = 2000, .group = ARBITER_COND_ALL },
	{ .fact_id = 3, .op = ARBITER_OP_EQ, .value = 1, .group = ARBITER_COND_ALL },
	{ .fact_id = 4, .op = ARBITER_OP_EQ, .value = 1, .group = ARBITER_COND_ALL },
	{ .fact_id = 5, .op = ARBITER_OP_EQ, .value = 0, .group = ARBITER_COND_ALL },
	{ .fact_id = 3, .op = ARBITER_OP_EQ, .value = 0, .group = ARBITER_COND_ALL },
	{ .fact_id = 5, .op = ARBITER_OP_EQ, .value = 1, .group = ARBITER_COND_ALL },
	{ .fact_id = 7, .op = ARBITER_OP_GE, .value = 80, .group = ARBITER_COND_ALL },
	{ .fact_id = 5, .op = ARBITER_OP_EQ, .value = 1, .group = ARBITER_COND_ALL },
	{ .fact_id = 1, .op = ARBITER_OP_EQ, .value = 1, .group = ARBITER_COND_ALL },
	{ .fact_id = 5, .op = ARBITER_OP_EQ, .value = 2, .group = ARBITER_COND_ALL },
	{ .fact_id = 7, .op = ARBITER_OP_GE, .value = 90, .group = ARBITER_COND_ALL },
	{ .fact_id = 5, .op = ARBITER_OP_EQ, .value = 3, .group = ARBITER_COND_ALL },
	{ .fact_id = 6, .op = ARBITER_OP_GT, .value = 30000, .group = ARBITER_COND_ALL },
	{ .fact_id = 5, .op = ARBITER_OP_EQ, .value = 3, .group = ARBITER_COND_ALL },
	{ .fact_id = 2, .op = ARBITER_OP_EQ, .value = 1, .group = ARBITER_COND_ALL },
	{ .fact_id = 5, .op = ARBITER_OP_EQ, .value = 4, .group = ARBITER_COND_ALL },
	{ .fact_id = 7, .op = ARBITER_OP_LE, .value = 5, .group = ARBITER_COND_ALL },
	{ .fact_id = 5, .op = ARBITER_OP_EQ, .value = 5, .group = ARBITER_COND_ALL },
	{ .fact_id = 8, .op = ARBITER_OP_LT, .value = 1100, .group = ARBITER_COND_ALL },
};

static const struct ARBITER_action_def model_actions[] = {
	{ .id = 0, .type = ARBITER_ACTION_CALLBACK, .target_fact_id = 0, .target_value = 0, .callback = NULL, .must_complete_within_ms = 0, .safe_state_action = true, .name = "close_all_valves" },
	{ .id = 1, .type = ARBITER_ACTION_CALLBACK, .target_fact_id = 0, .target_value = 0, .callback = NULL, .must_complete_within_ms = 0, .safe_state_action = false, .name = "close_inlet_open_reagent" },
	{ .id = 2, .type = ARBITER_ACTION_CALLBACK, .target_fact_id = 0, .target_value = 0, .callback = NULL, .must_complete_within_ms = 0, .safe_state_action = false, .name = "close_outlet_open_vent" },
	{ .id = 3, .type = ARBITER_ACTION_CALLBACK, .target_fact_id = 0, .target_value = 0, .callback = NULL, .must_complete_within_ms = 0, .safe_state_action = false, .name = "close_reagent" },
	{ .id = 4, .type = ARBITER_ACTION_CALLBACK, .target_fact_id = 0, .target_value = 0, .callback = NULL, .must_complete_within_ms = 50, .safe_state_action = true, .name = "emergency_cool" },
	{ .id = 5, .type = ARBITER_ACTION_CALLBACK, .target_fact_id = 0, .target_value = 0, .callback = NULL, .must_complete_within_ms = 10, .safe_state_action = true, .name = "emergency_vent" },
	{ .id = 6, .type = ARBITER_ACTION_CALLBACK, .target_fact_id = 0, .target_value = 0, .callback = NULL, .must_complete_within_ms = 0, .safe_state_action = false, .name = "open_inlet" },
	{ .id = 7, .type = ARBITER_ACTION_CALLBACK, .target_fact_id = 0, .target_value = 0, .callback = NULL, .must_complete_within_ms = 0, .safe_state_action = false, .name = "open_outlet" },
};

static const struct ARBITER_rule_def model_rules[] = {
	{ .id = 0, .rule_class = ARBITER_RULE_SAFETY_GUARD, .condition_start = 0, .condition_count = 1, .action_start = 5, .action_count = 1, .expr_start = 0, .expr_count = 1, .safety_goal_id = UINT16_MAX, .set_mode = 6, .safety_critical = true, .name = "01_safety.overpressure", .explanation = "Pressure > 1500 kPa — emergency vent." },
	{ .id = 1, .rule_class = ARBITER_RULE_SAFETY_GUARD, .condition_start = 1, .condition_count = 1, .action_start = 4, .action_count = 1, .expr_start = 1, .expr_count = 1, .safety_goal_id = UINT16_MAX, .set_mode = 7, .safety_critical = true, .name = "02_safety.overtemp", .explanation = "Temperature > 200°C — emergency cooling." },
	{ .id = 2, .rule_class = ARBITER_RULE_SAFETY_GUARD, .condition_start = 2, .condition_count = 1, .action_start = 0, .action_count = 1, .expr_start = 2, .expr_count = 1, .safety_goal_id = UINT16_MAX, .set_mode = 0, .safety_critical = true, .name = "03_safety.abort", .explanation = "Operator abort — close all valves." },
	{ .id = 3, .rule_class = ARBITER_RULE_INFERENCE, .condition_start = 3, .condition_count = 3, .action_start = 6, .action_count = 1, .expr_start = 3, .expr_count = 2, .safety_goal_id = UINT16_MAX, .set_mode = 4, .safety_critical = false, .name = "10_seq.start", .explanation = "Sequence started — open inlet valve, begin fill." },
	{ .id = 4, .rule_class = ARBITER_RULE_INFERENCE, .condition_start = 6, .condition_count = 2, .action_start = 0, .action_count = 0, .expr_start = 5, .expr_count = 1, .safety_goal_id = UINT16_MAX, .set_mode = UINT16_MAX, .safety_critical = false, .name = "11_seq.fill_check", .explanation = "Fill reached 80% — ready for reagent." },
	{ .id = 5, .rule_class = ARBITER_RULE_INFERENCE, .condition_start = 8, .condition_count = 2, .action_start = 1, .action_count = 1, .expr_start = 6, .expr_count = 2, .safety_goal_id = UINT16_MAX, .set_mode = 1, .safety_critical = false, .name = "12_seq.add_reagent", .explanation = "Close inlet, open reagent valve." },
	{ .id = 6, .rule_class = ARBITER_RULE_INFERENCE, .condition_start = 10, .condition_count = 2, .action_start = 3, .action_count = 1, .expr_start = 8, .expr_count = 2, .safety_goal_id = UINT16_MAX, .set_mode = 8, .safety_critical = false, .name = "13_seq.react", .explanation = "Reagent added — begin reaction hold." },
	{ .id = 7, .rule_class = ARBITER_RULE_INFERENCE, .condition_start = 12, .condition_count = 2, .action_start = 0, .action_count = 0, .expr_start = 10, .expr_count = 1, .safety_goal_id = UINT16_MAX, .set_mode = UINT16_MAX, .safety_critical = false, .name = "14_seq.reaction_timer", .explanation = "Reaction hold > 30s — reaction complete." },
	{ .id = 8, .rule_class = ARBITER_RULE_INFERENCE, .condition_start = 14, .condition_count = 2, .action_start = 7, .action_count = 1, .expr_start = 11, .expr_count = 1, .safety_goal_id = UINT16_MAX, .set_mode = 3, .safety_critical = false, .name = "15_seq.drain", .explanation = "Begin drain — open outlet valve." },
	{ .id = 9, .rule_class = ARBITER_RULE_INFERENCE, .condition_start = 16, .condition_count = 2, .action_start = 2, .action_count = 1, .expr_start = 12, .expr_count = 1, .safety_goal_id = UINT16_MAX, .set_mode = 9, .safety_critical = false, .name = "16_seq.drain_check", .explanation = "Drained — close outlet, open vent." },
	{ .id = 10, .rule_class = ARBITER_RULE_INFERENCE, .condition_start = 18, .condition_count = 2, .action_start = 0, .action_count = 1, .expr_start = 13, .expr_count = 1, .safety_goal_id = UINT16_MAX, .set_mode = 2, .safety_critical = false, .name = "17_seq.complete", .explanation = "Pressure vented — sequence complete." },
};

static const struct ARBITER_expr_def model_expressions[] = {
	{ .target_fact_id = 5, .op = ARBITER_EXPR_ASSIGN, .left_fact_id = 65535, .left_literal = 0, .right_fact_id = 65535, .right_literal = 0, .scale = 1 },
	{ .target_fact_id = 5, .op = ARBITER_EXPR_ASSIGN, .left_fact_id = 65535, .left_literal = 0, .right_fact_id = 65535, .right_literal = 0, .scale = 1 },
	{ .target_fact_id = 5, .op = ARBITER_EXPR_ASSIGN, .left_fact_id = 65535, .left_literal = 0, .right_fact_id = 65535, .right_literal = 0, .scale = 1 },
	{ .target_fact_id = 5, .op = ARBITER_EXPR_ASSIGN, .left_fact_id = 65535, .left_literal = 1, .right_fact_id = 65535, .right_literal = 0, .scale = 1 },
	{ .target_fact_id = 6, .op = ARBITER_EXPR_ASSIGN, .left_fact_id = 65535, .left_literal = 0, .right_fact_id = 65535, .right_literal = 0, .scale = 1 },
	{ .target_fact_id = 1, .op = ARBITER_EXPR_ASSIGN, .left_fact_id = 65535, .left_literal = 1, .right_fact_id = 65535, .right_literal = 0, .scale = 1 },
	{ .target_fact_id = 5, .op = ARBITER_EXPR_ASSIGN, .left_fact_id = 65535, .left_literal = 2, .right_fact_id = 65535, .right_literal = 0, .scale = 1 },
	{ .target_fact_id = 6, .op = ARBITER_EXPR_ASSIGN, .left_fact_id = 65535, .left_literal = 0, .right_fact_id = 65535, .right_literal = 0, .scale = 1 },
	{ .target_fact_id = 5, .op = ARBITER_EXPR_ASSIGN, .left_fact_id = 65535, .left_literal = 3, .right_fact_id = 65535, .right_literal = 0, .scale = 1 },
	{ .target_fact_id = 6, .op = ARBITER_EXPR_ASSIGN, .left_fact_id = 65535, .left_literal = 0, .right_fact_id = 65535, .right_literal = 0, .scale = 1 },
	{ .target_fact_id = 2, .op = ARBITER_EXPR_ASSIGN, .left_fact_id = 65535, .left_literal = 1, .right_fact_id = 65535, .right_literal = 0, .scale = 1 },
	{ .target_fact_id = 5, .op = ARBITER_EXPR_ASSIGN, .left_fact_id = 65535, .left_literal = 4, .right_fact_id = 65535, .right_literal = 0, .scale = 1 },
	{ .target_fact_id = 5, .op = ARBITER_EXPR_ASSIGN, .left_fact_id = 65535, .left_literal = 5, .right_fact_id = 65535, .right_literal = 0, .scale = 1 },
	{ .target_fact_id = 5, .op = ARBITER_EXPR_ASSIGN, .left_fact_id = 65535, .left_literal = 0, .right_fact_id = 65535, .right_literal = 0, .scale = 1 },
};

static const char *model_mode_names[] = {
	"mode.abort",
	"mode.add_reagent",
	"mode.complete",
	"mode.drain",
	"mode.fill",
	"mode.idle",
	"mode.overpressure",
	"mode.overtemp",
	"mode.react",
	"mode.vent",
};

const struct ARBITER_model ARBITER_generated_model = {
	.name = "valve_sequencer",
	.model_hash = { 0x28, 0x13, 0xd2, 0x36, 0x26, 0xbf, 0x1f, 0xa2, 0xeb, 0xcb, 0x7f, 0x98, 0xa1, 0x0b, 0x6c, 0xa1, 0x94, 0x6e, 0x91, 0xc2, 0x13, 0x61, 0x04, 0x43, 0xc3, 0x1d, 0xcf, 0x46, 0x34, 0xae, 0x92, 0x17 },
	.schema_hash = { 0x0d, 0x55, 0x33, 0x65, 0xf3, 0x4e, 0x02, 0xf3, 0xf8, 0x94, 0xe8, 0x25, 0xbb, 0x47, 0x86, 0x45, 0xfd, 0x8b, 0x78, 0xb1, 0x27, 0xf5, 0x8c, 0x42, 0xba, 0xbd, 0x80, 0x1f, 0x77, 0x57, 0x1f, 0x35 },
	.fact_count = 14,
	.rule_count = 11,
	.condition_count = 20,
	.action_count = 8,
	.expr_count = 14,
	.mode_count = 10,
	.facts = model_facts,
	.rules = model_rules,
	.conditions = model_conditions,
	.actions = model_actions,
	.expressions = model_expressions,
	.mode_names = model_mode_names,
};
```

## src/arbiter_model.h
```c
/* SPDX-License-Identifier: MIT */
/* AUTO-GENERATED by arbiterc — do not edit */

#pragma once

#include <stdint.h>
#include <stddef.h>
#include <arbiter/arbiter_model.h>

#define ARBITER_MODEL_NAME "valve_sequencer"
#define ARBITER_MODEL_HASH "2813d23626bf1fa2ebcb7f98a10b6ca1946e91c213610443c31dcf4634ae9217"
#define ARBITER_MODEL_FACT_COUNT 14u
#define ARBITER_MODEL_RULE_COUNT 11u
#define ARBITER_MODEL_CONDITION_COUNT 20u
#define ARBITER_MODEL_ACTION_COUNT 8u
#define ARBITER_MODEL_MAX_FACTS 14u
#define ARBITER_MODEL_MAX_RULES 11u
#define ARBITER_MODEL_MAX_CONDITIONS 20u
#define ARBITER_MODEL_MAX_ACTIONS 8u
#define ARBITER_MODEL_WCET_OP_COUNT 31u
#define ARBITER_MODEL_TRACE_CAPACITY 11u

extern const struct ARBITER_model ARBITER_generated_model;

#define ARBITER_FACT_CALC_DRAIN_COMPLETE 0u
#define ARBITER_FACT_CALC_FILL_COMPLETE 1u
#define ARBITER_FACT_CALC_REACTION_COMPLETE 2u
#define ARBITER_FACT_PROC_ABORT_CMD 3u
#define ARBITER_FACT_PROC_START_CMD 4u
#define ARBITER_FACT_PROC_STEP 5u
#define ARBITER_FACT_PROC_STEP_TIMER_MS 6u
#define ARBITER_FACT_SENSOR_LEVEL_PCT 7u
#define ARBITER_FACT_SENSOR_PRESSURE_KPA 8u
#define ARBITER_FACT_SENSOR_TEMP_C 9u
#define ARBITER_FACT_VALVE_INLET 10u
#define ARBITER_FACT_VALVE_OUTLET 11u
#define ARBITER_FACT_VALVE_REAGENT 12u
#define ARBITER_FACT_VALVE_VENT 13u

#define ARBITER_MODE_MODE_ABORT 0u
#define ARBITER_MODE_MODE_ADD_REAGENT 1u
#define ARBITER_MODE_MODE_COMPLETE 2u
#define ARBITER_MODE_MODE_DRAIN 3u
#define ARBITER_MODE_MODE_FILL 4u
#define ARBITER_MODE_MODE_IDLE 5u
#define ARBITER_MODE_MODE_OVERPRESSURE 6u
#define ARBITER_MODE_MODE_OVERTEMP 7u
#define ARBITER_MODE_MODE_REACT 8u
#define ARBITER_MODE_MODE_VENT 9u
```
