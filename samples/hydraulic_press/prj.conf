## CMakeLists.txt
```
# SPDX-License-Identifier: MIT

cmake_minimum_required(VERSION 3.20.0)
find_package(Zephyr REQUIRED HINTS $ENV{ZEPHYR_BASE})
project(hydraulic_press)

target_sources(app PRIVATE src/main.c src/arbiter_model.c)
```

## sample.yaml
```
sample:
  name: arbiter Hydraulic Press Interlock
  description: >
    Industrial hydraulic press safety interlock with guard monitoring,
    two-hand control, overpressure/overforce protection, thermal limits,
    and position-based stroke control. Uses strict safety profile.
common:
  tags: arbiter reasoning safety hydraulic press interlock iec-62061
  platform_allow: native_sim
tests:
  sample.arbiter.hydraulic-press:
    tags: arbiter sample
    platform_allow: native_sim
    build_only: true
```

## prj.conf
```kconfig
CONFIG_ARBITER=y
CONFIG_ARBITER_TRACE=y
CONFIG_ARBITER_SAFETY_STRICT=y
CONFIG_LOG=y
CONFIG_PRINTK=y
```

## src/main.c
```c
/* SPDX-License-Identifier: MIT */

/**
 * Hydraulic Press Safety Interlock
 *
 * Demonstrates a classic industrial safety interlock using arbiter:
 * guard interlocks, two-hand control, overpressure protection,
 * thermal monitoring, and position limits. Modeled after IEC 62061
 * and ISO 13849 patterns.
 */

#include <zephyr/kernel.h>
#include <zephyr/logging/log.h>
#include <arbiter/arbiter.h>

LOG_MODULE_REGISTER(press_sample, LOG_LEVEL_INF);

extern const struct ARBITER_model ARBITER_generated_model;

static struct ARBITER_ctx ctx;

/* Application callbacks */
void app_dump_pressure(void)
{
	LOG_WRN("SAFETY: Dumping hydraulic pressure!");
}

void app_hold_retract(void)
{
	LOG_WRN("SAFETY: Holding position / retracting ram");
}

void app_open_relief_valve(void)
{
	LOG_WRN("SAFETY: Relief valve opened");
}

void app_stop_pump(void)
{
	LOG_INF("POLICY: Hydraulic pump stopped");
}

void app_stop_advance(void)
{
	LOG_INF("POLICY: Ram advance stopped (limit)");
}

int main(void)
{
	LOG_INF("arbiter hydraulic press safety interlock");

	int ret = ARBITER_init(&ctx, &ARBITER_generated_model);

	if (ret != ARBITER_OK) {
		LOG_ERR("Init failed: %d", ret);
		return ret;
	}

	struct ARBITER_snapshot snap;
	struct ARBITER_result result;
	struct ARBITER_trace_entry trace_buf[16];
	struct ARBITER_trace trace;
	uint16_t mode;

	/*
	 * Scenario 1: All interlocks satisfied — ready to press
	 */
	LOG_INF("--- Scenario: Ready to press ---");
	/* Facts are in canonical (alphabetical) order by id */
	ARBITER_set_bool(&ctx, 0, true);   /* guard.closed */
	ARBITER_set_bool(&ctx, 1, true);   /* guard.locked */
	ARBITER_set_bool(&ctx, 2, true);   /* press.cycle_start */
	ARBITER_set_u32(&ctx, 3, 0);       /* press.cycle_count */
	ARBITER_set_bool(&ctx, 4, false);  /* press.estop */
	ARBITER_set_u32(&ctx, 5, 10000);   /* press.force_kn = 1000 kN */
	ARBITER_set_i32(&ctx, 6, 350);     /* press.oil_temp_c = 35 °C */
	ARBITER_set_u32(&ctx, 7, 5000);    /* press.pressure_bar = 500 bar */
	ARBITER_set_i32(&ctx, 8, 1000);    /* press.ram_position_mm = 100 mm */
	ARBITER_set_bool(&ctx, 9, true);   /* twohand.left */
	ARBITER_set_bool(&ctx, 10, true);  /* twohand.right */

	ARBITER_trace_init(&trace, trace_buf, 16);
	ARBITER_snapshot_begin(&ctx, &snap);
	ARBITER_eval(&ARBITER_generated_model, &snap, &result, &trace);
	ARBITER_get_mode(&result, &mode);
	LOG_INF("  Mode: %u  Actions: %u", mode, result.requested_action_count);

	/*
	 * Scenario 2: Guard opened mid-cycle
	 */
	LOG_INF("--- Scenario: Guard opened ---");
	ARBITER_set_bool(&ctx, 0, false);  /* guard.closed = false */

	ARBITER_trace_reset(&trace);
	ARBITER_snapshot_begin(&ctx, &snap);
	ARBITER_eval(&ARBITER_generated_model, &snap, &result, &trace);
	ARBITER_get_mode(&result, &mode);
	LOG_INF("  Mode: %u  Actions: %u", mode, result.requested_action_count);

	/*
	 * Scenario 3: E-stop pressed
	 */
	LOG_INF("--- Scenario: E-stop ---");
	ARBITER_set_bool(&ctx, 0, true);   /* guard.closed = true */
	ARBITER_set_bool(&ctx, 4, true);   /* press.estop = true */

	ARBITER_trace_reset(&trace);
	ARBITER_snapshot_begin(&ctx, &snap);
	ARBITER_eval(&ARBITER_generated_model, &snap, &result, &trace);
	ARBITER_get_mode(&result, &mode);
	LOG_INF("  Mode: %u  Actions: %u", mode, result.requested_action_count);

	return 0;
}
```

## src/arbiter_model.c
```c
/* SPDX-License-Identifier: MIT */
/* AUTO-GENERATED by arbiterc — do not edit */

#include "arbiter_model.h"
#include <arbiter/arbiter.h>

static const struct ARBITER_fact_def model_facts[] = {
	{ .id = 0, .type = ARBITER_FACT_BOOL, .range_min = 0, .range_max = 0, .default_value = 0, .stale_after_ms = 0, .safety_relevant = true, .name = "guard.closed" },
	{ .id = 1, .type = ARBITER_FACT_BOOL, .range_min = 0, .range_max = 0, .default_value = 0, .stale_after_ms = 0, .safety_relevant = true, .name = "guard.locked" },
	{ .id = 2, .type = ARBITER_FACT_UINT32, .range_min = 0, .range_max = 2000000000, .default_value = 0, .stale_after_ms = 0, .safety_relevant = false, .name = "press.cycle_count" },
	{ .id = 3, .type = ARBITER_FACT_BOOL, .range_min = 0, .range_max = 0, .default_value = 0, .stale_after_ms = 0, .safety_relevant = false, .name = "press.cycle_start" },
	{ .id = 4, .type = ARBITER_FACT_BOOL, .range_min = 0, .range_max = 0, .default_value = 0, .stale_after_ms = 0, .safety_relevant = true, .name = "press.estop" },
	{ .id = 5, .type = ARBITER_FACT_UINT32, .range_min = 0, .range_max = 50000, .default_value = 0, .stale_after_ms = 20, .safety_relevant = true, .name = "press.force_kn" },
	{ .id = 6, .type = ARBITER_FACT_INT32, .range_min = -200, .range_max = 900, .default_value = 0, .stale_after_ms = 5000, .safety_relevant = false, .name = "press.oil_temp_c" },
	{ .id = 7, .type = ARBITER_FACT_UINT32, .range_min = 0, .range_max = 35000, .default_value = 0, .stale_after_ms = 20, .safety_relevant = true, .name = "press.pressure_bar" },
	{ .id = 8, .type = ARBITER_FACT_INT32, .range_min = 0, .range_max = 6000, .default_value = 0, .stale_after_ms = 10, .safety_relevant = true, .name = "press.ram_position_mm" },
	{ .id = 9, .type = ARBITER_FACT_BOOL, .range_min = 0, .range_max = 0, .default_value = 0, .stale_after_ms = 0, .safety_relevant = true, .name = "twohand.left" },
	{ .id = 10, .type = ARBITER_FACT_BOOL, .range_min = 0, .range_max = 0, .default_value = 0, .stale_after_ms = 0, .safety_relevant = true, .name = "twohand.right" },
};

static const struct ARBITER_condition_def model_conditions[] = {
	{ .fact_id = 8, .op = ARBITER_OP_GE, .value = 5900, .group = ARBITER_COND_ALL },
	{ .fact_id = 4, .op = ARBITER_OP_EQ, .value = 1, .group = ARBITER_COND_ALL },
	{ .fact_id = 0, .op = ARBITER_OP_EQ, .value = 0, .group = ARBITER_COND_ANY },
	{ .fact_id = 1, .op = ARBITER_OP_EQ, .value = 0, .group = ARBITER_COND_ANY },
	{ .fact_id = 6, .op = ARBITER_OP_GT, .value = 700, .group = ARBITER_COND_ALL },
	{ .fact_id = 5, .op = ARBITER_OP_GT, .value = 45000, .group = ARBITER_COND_ALL },
	{ .fact_id = 7, .op = ARBITER_OP_GT, .value = 30000, .group = ARBITER_COND_ALL },
	{ .fact_id = 3, .op = ARBITER_OP_EQ, .value = 1, .group = ARBITER_COND_ALL },
	{ .fact_id = 0, .op = ARBITER_OP_EQ, .value = 1, .group = ARBITER_COND_ALL },
	{ .fact_id = 1, .op = ARBITER_OP_EQ, .value = 1, .group = ARBITER_COND_ALL },
	{ .fact_id = 9, .op = ARBITER_OP_EQ, .value = 1, .group = ARBITER_COND_ALL },
	{ .fact_id = 10, .op = ARBITER_OP_EQ, .value = 1, .group = ARBITER_COND_ALL },
	{ .fact_id = 4, .op = ARBITER_OP_EQ, .value = 0, .group = ARBITER_COND_ALL },
	{ .fact_id = 7, .op = ARBITER_OP_LE, .value = 30000, .group = ARBITER_COND_ALL },
	{ .fact_id = 9, .op = ARBITER_OP_EQ, .value = 0, .group = ARBITER_COND_ANY },
	{ .fact_id = 10, .op = ARBITER_OP_EQ, .value = 0, .group = ARBITER_COND_ANY },
};

static const struct ARBITER_action_def model_actions[] = {
	{ .id = 0, .type = ARBITER_ACTION_CALLBACK, .target_fact_id = 0, .target_value = 0, .callback = NULL, .must_complete_within_ms = 10, .safe_state_action = true, .name = "dump_pressure" },
	{ .id = 1, .type = ARBITER_ACTION_CALLBACK, .target_fact_id = 0, .target_value = 0, .callback = NULL, .must_complete_within_ms = 50, .safe_state_action = true, .name = "hold_retract" },
	{ .id = 2, .type = ARBITER_ACTION_CALLBACK, .target_fact_id = 0, .target_value = 0, .callback = NULL, .must_complete_within_ms = 5, .safe_state_action = true, .name = "open_relief" },
	{ .id = 3, .type = ARBITER_ACTION_CALLBACK, .target_fact_id = 0, .target_value = 0, .callback = NULL, .must_complete_within_ms = 0, .safe_state_action = false, .name = "stop_advance" },
	{ .id = 4, .type = ARBITER_ACTION_CALLBACK, .target_fact_id = 0, .target_value = 0, .callback = NULL, .must_complete_within_ms = 0, .safe_state_action = false, .name = "stop_pump" },
};

static const struct ARBITER_rule_def model_rules[] = {
	{ .id = 0, .rule_class = ARBITER_RULE_CONSTRAINT, .condition_start = 0, .condition_count = 1, .action_start = 3, .action_count = 1, .expr_start = 0, .expr_count = 0, .safety_goal_id = UINT16_MAX, .set_mode = UINT16_MAX, .safety_critical = false, .name = "rule.bottom_limit", .explanation = "Ram at bottom of stroke — stop advance." },
	{ .id = 1, .rule_class = ARBITER_RULE_SAFETY_GUARD, .condition_start = 1, .condition_count = 1, .action_start = 0, .action_count = 1, .expr_start = 0, .expr_count = 0, .safety_goal_id = UINT16_MAX, .set_mode = 1, .safety_critical = true, .name = "rule.estop", .explanation = "E-stop active — dump hydraulic pressure immediately." },
	{ .id = 2, .rule_class = ARBITER_RULE_SAFETY_GUARD, .condition_start = 2, .condition_count = 2, .action_start = 1, .action_count = 1, .expr_start = 0, .expr_count = 0, .safety_goal_id = UINT16_MAX, .set_mode = 3, .safety_critical = true, .name = "rule.guard_open", .explanation = "Guard not closed+locked — cannot press." },
	{ .id = 3, .rule_class = ARBITER_RULE_MODE_GUARD, .condition_start = 4, .condition_count = 1, .action_start = 4, .action_count = 1, .expr_start = 0, .expr_count = 0, .safety_goal_id = UINT16_MAX, .set_mode = 9, .safety_critical = false, .name = "rule.oil_overtemp", .explanation = "Oil > 70°C — stop pump to prevent seal damage." },
	{ .id = 4, .rule_class = ARBITER_RULE_SAFETY_GUARD, .condition_start = 5, .condition_count = 1, .action_start = 0, .action_count = 1, .expr_start = 0, .expr_count = 0, .safety_goal_id = UINT16_MAX, .set_mode = 6, .safety_critical = true, .name = "rule.overforce", .explanation = "Force > 4500 kN — exceeds press rating." },
	{ .id = 5, .rule_class = ARBITER_RULE_SAFETY_GUARD, .condition_start = 6, .condition_count = 1, .action_start = 2, .action_count = 1, .expr_start = 0, .expr_count = 0, .safety_goal_id = UINT16_MAX, .set_mode = 6, .safety_critical = true, .name = "rule.overpressure", .explanation = "Pressure > 3000 bar — open relief valve." },
	{ .id = 6, .rule_class = ARBITER_RULE_INFERENCE, .condition_start = 7, .condition_count = 7, .action_start = 0, .action_count = 0, .expr_start = 0, .expr_count = 0, .safety_goal_id = UINT16_MAX, .set_mode = 0, .safety_critical = false, .name = "rule.ready_to_press", .explanation = "All interlocks satisfied — begin approach stroke." },
	{ .id = 7, .rule_class = ARBITER_RULE_SAFETY_GUARD, .condition_start = 14, .condition_count = 2, .action_start = 1, .action_count = 1, .expr_start = 0, .expr_count = 0, .safety_goal_id = UINT16_MAX, .set_mode = 5, .safety_critical = true, .name = "rule.twohand_release", .explanation = "Two-hand control released — operator may be in zone." },
};

static const char *model_mode_names[] = {
	"mode.approach",
	"mode.estop",
	"mode.guard_check",
	"mode.guard_fault",
	"mode.hold",
	"mode.idle",
	"mode.overpressure_fault",
	"mode.pressing",
	"mode.retract",
	"mode.thermal_fault",
};

const struct ARBITER_model ARBITER_generated_model = {
	.name = "hydraulic_press_interlock",
	.model_hash = { 0xfa, 0xd1, 0xdc, 0x7a, 0x85, 0xbc, 0x74, 0x4a, 0x5a, 0x05, 0x1e, 0x63, 0x23, 0x51, 0xc9, 0xbc, 0xeb, 0x1f, 0x71, 0xf0, 0x6a, 0xd1, 0xee, 0x53, 0x78, 0x33, 0xc3, 0xad, 0x02, 0x0d, 0xa9, 0xd7 },
	.schema_hash = { 0x0d, 0x55, 0x33, 0x65, 0xf3, 0x4e, 0x02, 0xf3, 0xf8, 0x94, 0xe8, 0x25, 0xbb, 0x47, 0x86, 0x45, 0xfd, 0x8b, 0x78, 0xb1, 0x27, 0xf5, 0x8c, 0x42, 0xba, 0xbd, 0x80, 0x1f, 0x77, 0x57, 0x1f, 0x35 },
	.fact_count = 11,
	.rule_count = 8,
	.condition_count = 16,
	.action_count = 5,
	.expr_count = 0,
	.mode_count = 10,
	.facts = model_facts,
	.rules = model_rules,
	.conditions = model_conditions,
	.actions = model_actions,
	.expressions = NULL,
	.mode_names = model_mode_names,
};
```

## src/arbiter_model.h
```c
/* SPDX-License-Identifier: MIT */
/* AUTO-GENERATED by arbiterc — do not edit */

#pragma once

#include <stdint.h>
#include <stddef.h>
#include <arbiter/arbiter_model.h>

#define ARBITER_MODEL_NAME "hydraulic_press_interlock"
#define ARBITER_MODEL_HASH "fad1dc7a85bc744a5a051e632351c9bceb1f71f06ad1ee537833c3ad020da9d7"
#define ARBITER_MODEL_FACT_COUNT 11u
#define ARBITER_MODEL_RULE_COUNT 8u
#define ARBITER_MODEL_CONDITION_COUNT 16u
#define ARBITER_MODEL_ACTION_COUNT 5u
#define ARBITER_MODEL_MAX_FACTS 11u
#define ARBITER_MODEL_MAX_RULES 8u
#define ARBITER_MODEL_MAX_CONDITIONS 16u
#define ARBITER_MODEL_MAX_ACTIONS 5u
#define ARBITER_MODEL_WCET_OP_COUNT 24u
#define ARBITER_MODEL_TRACE_CAPACITY 8u

extern const struct ARBITER_model ARBITER_generated_model;

#define ARBITER_FACT_GUARD_CLOSED 0u
#define ARBITER_FACT_GUARD_LOCKED 1u
#define ARBITER_FACT_PRESS_CYCLE_COUNT 2u
#define ARBITER_FACT_PRESS_CYCLE_START 3u
#define ARBITER_FACT_PRESS_ESTOP 4u
#define ARBITER_FACT_PRESS_FORCE_KN 5u
#define ARBITER_FACT_PRESS_OIL_TEMP_C 6u
#define ARBITER_FACT_PRESS_PRESSURE_BAR 7u
#define ARBITER_FACT_PRESS_RAM_POSITION_MM 8u
#define ARBITER_FACT_TWOHAND_LEFT 9u
#define ARBITER_FACT_TWOHAND_RIGHT 10u

#define ARBITER_MODE_MODE_APPROACH 0u
#define ARBITER_MODE_MODE_ESTOP 1u
#define ARBITER_MODE_MODE_GUARD_CHECK 2u
#define ARBITER_MODE_MODE_GUARD_FAULT 3u
#define ARBITER_MODE_MODE_HOLD 4u
#define ARBITER_MODE_MODE_IDLE 5u
#define ARBITER_MODE_MODE_OVERPRESSURE_FAULT 6u
#define ARBITER_MODE_MODE_PRESSING 7u
#define ARBITER_MODE_MODE_RETRACT 8u
#define ARBITER_MODE_MODE_THERMAL_FAULT 9u
```
