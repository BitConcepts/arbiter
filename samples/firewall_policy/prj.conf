## CMakeLists.txt
```
# SPDX-License-Identifier: MIT

cmake_minimum_required(VERSION 3.20.0)
find_package(Zephyr REQUIRED HINTS $ENV{ZEPHYR_BASE})
project(firewallpolicy)

target_sources(app PRIVATE src/main.c src/arbiter_model.c)
```

## sample.yaml
```
sample:
  name: arbiter Embedded Firewall
  description: >
    Stateful packet filtering engine. arbiter reasons about blocklists,
    established connections, SYN flood detection (computed score),
    port-based rules, ICMP rate limiting, DPI anomalies, and default
    deny. Imports ARB://network_common for shared network facts.
common:
  tags: arbiter reasoning firewall security network iot
  platform_allow: native_sim
tests:
  sample.arbiter.firewall-policy:
    tags: arbiter sample
    platform_allow: native_sim
    build_only: true
```

## prj.conf
```kconfig
CONFIG_ARBITER=y
CONFIG_ARBITER_TRACE=y
CONFIG_LOG=y
CONFIG_PRINTK=y
```

## src/main.c
```c
/* SPDX-License-Identifier: MIT */

#include <zephyr/kernel.h>
#include <zephyr/logging/log.h>
#include <arbiter/arbiter.h>

LOG_MODULE_REGISTER(firewall, LOG_LEVEL_INF);

extern const struct ARBITER_model ARBITER_generated_model;
static struct ARBITER_ctx ctx;

void app_fw_drop_packet(void)       { LOG_WRN("FW: DROP"); }
void app_fw_enable_syn_cookies(void){ LOG_WRN("FW: SYN cookies enabled"); }
void app_fw_log_anomaly(void)       { LOG_WRN("FW: Anomaly logged"); }
void app_net_throttle(void)         { LOG_INF("FW: Throttling"); }
void app_net_reject_new_conn(void)  { LOG_INF("FW: Rejecting new conn"); }

/* Fact indices (canonical alphabetical order across imports) */
enum {
	F_ACTION = 0, F_ICMP_RATE, F_IS_DNS, F_IS_SYN,
	F_ANOMALY, F_SRC_BLOCK, F_SRC_ALLOW, F_SYN_SCORE,
	F_CONN_COUNT, F_DST_PORT, F_ESTABLISHED, F_PKT_LEN,
	F_PROTOCOL, F_RATE_PPS, F_SRC_CLASS,
};

static void eval_packet(const char *desc, uint32_t port, uint32_t proto,
			bool blocklist, bool allowlist, bool established,
			bool syn, uint32_t rate)
{
	ARBITER_set_i32(&ctx, F_ACTION, 0); /* pending */
	ARBITER_set_u32(&ctx, F_DST_PORT, port);
	ARBITER_set_i32(&ctx, F_PROTOCOL, proto);
	ARBITER_set_bool(&ctx, F_SRC_BLOCK, blocklist);
	ARBITER_set_bool(&ctx, F_SRC_ALLOW, allowlist);
	ARBITER_set_bool(&ctx, F_ESTABLISHED, established);
	ARBITER_set_bool(&ctx, F_IS_SYN, syn);
	ARBITER_set_bool(&ctx, F_ANOMALY, false);
	ARBITER_set_bool(&ctx, F_IS_DNS, port == 53);
	ARBITER_set_u32(&ctx, F_RATE_PPS, rate);
	ARBITER_set_u32(&ctx, F_PKT_LEN, 128);
	ARBITER_set_u32(&ctx, F_ICMP_RATE, 0);
	ARBITER_set_u32(&ctx, F_CONN_COUNT, 10);

	struct ARBITER_snapshot snap;
	struct ARBITER_result result;

	ARBITER_snapshot_begin(&ctx, &snap);
	ARBITER_eval(&ARBITER_generated_model, &snap, &result, NULL);

	const char *actions[] = {"PENDING","ACCEPT","DROP","REJECT","LOG+ACCEPT","LOG+DROP"};
	int a = ctx.fact_values[F_ACTION].value;

	LOG_INF("  %-30s -> %s (rules=%u)", desc,
		(a >= 0 && a <= 5) ? actions[a] : "?",
		result.requested_action_count);
}

int main(void)
{
	LOG_INF("=== arbiter Embedded Firewall ===");
	ARBITER_init(&ctx, &ARBITER_generated_model);

	eval_packet("CoAP UDP/5683",        5683, 2, false, false, false, false, 50);
	eval_packet("MQTT-TLS TCP/8883",    8883, 1, false, false, false, false, 20);
	eval_packet("Blocklisted source",   80,   1, true,  false, false, false, 10);
	eval_packet("Allowlisted source",   443,  1, false, true,  false, false, 10);
	eval_packet("Established TCP",      8883, 1, false, false, true,  false, 100);
	eval_packet("SYN flood (6000 pps)", 80,   1, false, false, false, true,  6000);
	eval_packet("Unknown port (deny)",  9999, 1, false, false, false, false, 5);
	eval_packet("DNS query",            53,   2, false, false, false, false, 10);

	return 0;
}
```

## src/arbiter_model.c
```c
/* SPDX-License-Identifier: MIT */
/* AUTO-GENERATED by arbiterc — do not edit */

#include "arbiter_model.h"
#include <arbiter/arbiter.h>

static const struct ARBITER_fact_def model_facts[] = {
	{ .id = 0, .type = ARBITER_FACT_ENUM, .range_min = 0, .range_max = 0, .default_value = 0, .stale_after_ms = 0, .safety_relevant = false, .name = "fw.action" },
	{ .id = 1, .type = ARBITER_FACT_UINT32, .range_min = 0, .range_max = 10000, .default_value = 0, .stale_after_ms = 0, .safety_relevant = false, .name = "fw.icmp_rate" },
	{ .id = 2, .type = ARBITER_FACT_BOOL, .range_min = 0, .range_max = 0, .default_value = 0, .stale_after_ms = 0, .safety_relevant = false, .name = "fw.is_dns" },
	{ .id = 3, .type = ARBITER_FACT_BOOL, .range_min = 0, .range_max = 0, .default_value = 0, .stale_after_ms = 0, .safety_relevant = false, .name = "fw.is_syn" },
	{ .id = 4, .type = ARBITER_FACT_BOOL, .range_min = 0, .range_max = 0, .default_value = 0, .stale_after_ms = 0, .safety_relevant = false, .name = "fw.payload_anomaly" },
	{ .id = 5, .type = ARBITER_FACT_BOOL, .range_min = 0, .range_max = 0, .default_value = 0, .stale_after_ms = 0, .safety_relevant = false, .name = "fw.src_on_allowlist" },
	{ .id = 6, .type = ARBITER_FACT_BOOL, .range_min = 0, .range_max = 0, .default_value = 0, .stale_after_ms = 0, .safety_relevant = false, .name = "fw.src_on_blocklist" },
	{ .id = 7, .type = ARBITER_FACT_UINT32, .range_min = 0, .range_max = 1000, .default_value = 0, .stale_after_ms = 0, .safety_relevant = false, .name = "fw.syn_flood_score" },
	{ .id = 8, .type = ARBITER_FACT_UINT32, .range_min = 0, .range_max = 65535, .default_value = 0, .stale_after_ms = 0, .safety_relevant = false, .name = "net.dst_port" },
	{ .id = 9, .type = ARBITER_FACT_BOOL, .range_min = 0, .range_max = 0, .default_value = 0, .stale_after_ms = 0, .safety_relevant = false, .name = "net.is_established" },
	{ .id = 10, .type = ARBITER_FACT_UINT32, .range_min = 0, .range_max = 65535, .default_value = 0, .stale_after_ms = 0, .safety_relevant = false, .name = "net.packet_len" },
	{ .id = 11, .type = ARBITER_FACT_UINT32, .range_min = 0, .range_max = 255, .default_value = 0, .stale_after_ms = 0, .safety_relevant = false, .name = "net.protocol" },
	{ .id = 12, .type = ARBITER_FACT_UINT32, .range_min = 0, .range_max = 100000, .default_value = 0, .stale_after_ms = 0, .safety_relevant = false, .name = "net.rate_pps" },
};

static const struct ARBITER_condition_def model_conditions[] = {
	{ .fact_id = 6, .op = ARBITER_OP_EQ, .value = 1, .group = ARBITER_COND_ALL },
	{ .fact_id = 5, .op = ARBITER_OP_EQ, .value = 1, .group = ARBITER_COND_ALL },
	{ .fact_id = 9, .op = ARBITER_OP_EQ, .value = 1, .group = ARBITER_COND_ALL },
	{ .fact_id = 4, .op = ARBITER_OP_EQ, .value = 0, .group = ARBITER_COND_ALL },
	{ .fact_id = 3, .op = ARBITER_OP_EQ, .value = 1, .group = ARBITER_COND_ALL },
	{ .fact_id = 7, .op = ARBITER_OP_GT, .value = 500, .group = ARBITER_COND_ALL },
	{ .fact_id = 8, .op = ARBITER_OP_EQ, .value = 5683, .group = ARBITER_COND_ALL },
	{ .fact_id = 11, .op = ARBITER_OP_EQ, .value = 2, .group = ARBITER_COND_ALL },
	{ .fact_id = 8, .op = ARBITER_OP_EQ, .value = 8883, .group = ARBITER_COND_ALL },
	{ .fact_id = 11, .op = ARBITER_OP_EQ, .value = 1, .group = ARBITER_COND_ALL },
	{ .fact_id = 2, .op = ARBITER_OP_EQ, .value = 1, .group = ARBITER_COND_ALL },
	{ .fact_id = 10, .op = ARBITER_OP_LE, .value = 512, .group = ARBITER_COND_ALL },
	{ .fact_id = 11, .op = ARBITER_OP_EQ, .value = 3, .group = ARBITER_COND_ALL },
	{ .fact_id = 1, .op = ARBITER_OP_GT, .value = 10, .group = ARBITER_COND_ALL },
	{ .fact_id = 4, .op = ARBITER_OP_EQ, .value = 1, .group = ARBITER_COND_ALL },
	{ .fact_id = 0, .op = ARBITER_OP_EQ, .value = 0, .group = ARBITER_COND_ALL },
};

static const struct ARBITER_action_def model_actions[] = {
	{ .id = 0, .type = ARBITER_ACTION_CALLBACK, .target_fact_id = 0, .target_value = 0, .callback = NULL, .must_complete_within_ms = 0, .safe_state_action = false, .name = "fw_drop" },
	{ .id = 1, .type = ARBITER_ACTION_CALLBACK, .target_fact_id = 0, .target_value = 0, .callback = NULL, .must_complete_within_ms = 0, .safe_state_action = false, .name = "fw_enable_syn_cookies" },
	{ .id = 2, .type = ARBITER_ACTION_CALLBACK, .target_fact_id = 0, .target_value = 0, .callback = NULL, .must_complete_within_ms = 0, .safe_state_action = false, .name = "fw_log_anomaly" },
};

static const struct ARBITER_rule_def model_rules[] = {
	{ .id = 0, .rule_class = ARBITER_RULE_SAFETY_GUARD, .condition_start = 0, .condition_count = 1, .action_start = 0, .action_count = 1, .expr_start = 0, .expr_count = 1, .safety_goal_id = UINT16_MAX, .set_mode = UINT16_MAX, .safety_critical = true, .name = "01_fw.blocklist", .explanation = "Source on blocklist — drop and log." },
	{ .id = 1, .rule_class = ARBITER_RULE_INFERENCE, .condition_start = 1, .condition_count = 1, .action_start = 0, .action_count = 0, .expr_start = 1, .expr_count = 1, .safety_goal_id = UINT16_MAX, .set_mode = UINT16_MAX, .safety_critical = false, .name = "02_fw.allowlist", .explanation = "Source on allowlist — accept." },
	{ .id = 2, .rule_class = ARBITER_RULE_INFERENCE, .condition_start = 2, .condition_count = 2, .action_start = 0, .action_count = 0, .expr_start = 2, .expr_count = 1, .safety_goal_id = UINT16_MAX, .set_mode = UINT16_MAX, .safety_critical = false, .name = "10_fw.established", .explanation = "Established connection, no anomaly — accept." },
	{ .id = 3, .rule_class = ARBITER_RULE_INFERENCE, .condition_start = 4, .condition_count = 1, .action_start = 0, .action_count = 0, .expr_start = 3, .expr_count = 1, .safety_goal_id = UINT16_MAX, .set_mode = UINT16_MAX, .safety_critical = false, .name = "20_fw.syn_flood_score", .explanation = "Compute SYN flood risk from packet rate." },
	{ .id = 4, .rule_class = ARBITER_RULE_SAFETY_GUARD, .condition_start = 5, .condition_count = 1, .action_start = 1, .action_count = 1, .expr_start = 4, .expr_count = 1, .safety_goal_id = UINT16_MAX, .set_mode = 3, .safety_critical = true, .name = "21_fw.syn_flood_active", .explanation = "SYN flood detected (score > 500) — enable SYN cookies, drop." },
	{ .id = 5, .rule_class = ARBITER_RULE_INFERENCE, .condition_start = 6, .condition_count = 2, .action_start = 0, .action_count = 0, .expr_start = 5, .expr_count = 1, .safety_goal_id = UINT16_MAX, .set_mode = UINT16_MAX, .safety_critical = false, .name = "30_fw.allow_coap", .explanation = "CoAP (UDP/5683) — accept and log." },
	{ .id = 6, .rule_class = ARBITER_RULE_INFERENCE, .condition_start = 8, .condition_count = 2, .action_start = 0, .action_count = 0, .expr_start = 6, .expr_count = 1, .safety_goal_id = UINT16_MAX, .set_mode = UINT16_MAX, .safety_critical = false, .name = "31_fw.allow_mqtt", .explanation = "MQTT-TLS (TCP/8883) — accept." },
	{ .id = 7, .rule_class = ARBITER_RULE_INFERENCE, .condition_start = 10, .condition_count = 2, .action_start = 0, .action_count = 0, .expr_start = 7, .expr_count = 1, .safety_goal_id = UINT16_MAX, .set_mode = UINT16_MAX, .safety_critical = false, .name = "32_fw.allow_dns", .explanation = "DNS query (<=512 bytes) — accept." },
	{ .id = 8, .rule_class = ARBITER_RULE_CONSTRAINT, .condition_start = 12, .condition_count = 2, .action_start = 0, .action_count = 0, .expr_start = 8, .expr_count = 1, .safety_goal_id = UINT16_MAX, .set_mode = UINT16_MAX, .safety_critical = false, .name = "33_fw.icmp_flood", .explanation = "ICMP rate > 10 pps — drop (ping flood)." },
	{ .id = 9, .rule_class = ARBITER_RULE_SAFETY_GUARD, .condition_start = 14, .condition_count = 1, .action_start = 2, .action_count = 1, .expr_start = 9, .expr_count = 1, .safety_goal_id = UINT16_MAX, .set_mode = UINT16_MAX, .safety_critical = false, .name = "40_fw.dpi_anomaly", .explanation = "Payload anomaly — drop and log for analysis." },
	{ .id = 10, .rule_class = ARBITER_RULE_CONSTRAINT, .condition_start = 15, .condition_count = 1, .action_start = 0, .action_count = 0, .expr_start = 10, .expr_count = 1, .safety_goal_id = UINT16_MAX, .set_mode = UINT16_MAX, .safety_critical = false, .name = "99_fw.default_deny", .explanation = "Default deny — no rule matched." },
};

static const struct ARBITER_expr_def model_expressions[] = {
	{ .target_fact_id = 0, .op = ARBITER_EXPR_ASSIGN, .left_fact_id = 65535, .left_literal = 5, .right_fact_id = 65535, .right_literal = 0, .scale = 1 },
	{ .target_fact_id = 0, .op = ARBITER_EXPR_ASSIGN, .left_fact_id = 65535, .left_literal = 1, .right_fact_id = 65535, .right_literal = 0, .scale = 1 },
	{ .target_fact_id = 0, .op = ARBITER_EXPR_ASSIGN, .left_fact_id = 65535, .left_literal = 1, .right_fact_id = 65535, .right_literal = 0, .scale = 1 },
	{ .target_fact_id = 7, .op = ARBITER_EXPR_SCALE, .left_fact_id = 12, .left_literal = 0, .right_fact_id = 65535, .right_literal = 100, .scale = 1000 },
	{ .target_fact_id = 0, .op = ARBITER_EXPR_ASSIGN, .left_fact_id = 65535, .left_literal = 2, .right_fact_id = 65535, .right_literal = 0, .scale = 1 },
	{ .target_fact_id = 0, .op = ARBITER_EXPR_ASSIGN, .left_fact_id = 65535, .left_literal = 4, .right_fact_id = 65535, .right_literal = 0, .scale = 1 },
	{ .target_fact_id = 0, .op = ARBITER_EXPR_ASSIGN, .left_fact_id = 65535, .left_literal = 1, .right_fact_id = 65535, .right_literal = 0, .scale = 1 },
	{ .target_fact_id = 0, .op = ARBITER_EXPR_ASSIGN, .left_fact_id = 65535, .left_literal = 1, .right_fact_id = 65535, .right_literal = 0, .scale = 1 },
	{ .target_fact_id = 0, .op = ARBITER_EXPR_ASSIGN, .left_fact_id = 65535, .left_literal = 2, .right_fact_id = 65535, .right_literal = 0, .scale = 1 },
	{ .target_fact_id = 0, .op = ARBITER_EXPR_ASSIGN, .left_fact_id = 65535, .left_literal = 5, .right_fact_id = 65535, .right_literal = 0, .scale = 1 },
	{ .target_fact_id = 0, .op = ARBITER_EXPR_ASSIGN, .left_fact_id = 65535, .left_literal = 2, .right_fact_id = 65535, .right_literal = 0, .scale = 1 },
};

static const char *model_mode_names[] = {
	"mode.lockdown",
	"mode.normal",
	"mode.rate_limited",
	"mode.under_attack",
};

const struct ARBITER_model ARBITER_generated_model = {
	.name = "embedded_firewall",
	.model_hash = { 0x99, 0x78, 0x23, 0x9a, 0xcd, 0xbe, 0xc9, 0xad, 0x1c, 0xb1, 0x38, 0xb5, 0xc9, 0xeb, 0xe0, 0x27, 0xc8, 0x0a, 0x74, 0xe3, 0x25, 0x8d, 0x7b, 0xea, 0xcc, 0xe1, 0x06, 0x40, 0x93, 0x37, 0x5a, 0xba },
	.schema_hash = { 0x0d, 0x55, 0x33, 0x65, 0xf3, 0x4e, 0x02, 0xf3, 0xf8, 0x94, 0xe8, 0x25, 0xbb, 0x47, 0x86, 0x45, 0xfd, 0x8b, 0x78, 0xb1, 0x27, 0xf5, 0x8c, 0x42, 0xba, 0xbd, 0x80, 0x1f, 0x77, 0x57, 0x1f, 0x35 },
	.fact_count = 13,
	.rule_count = 11,
	.condition_count = 16,
	.action_count = 3,
	.expr_count = 11,
	.mode_count = 4,
	.facts = model_facts,
	.rules = model_rules,
	.conditions = model_conditions,
	.actions = model_actions,
	.expressions = model_expressions,
	.mode_names = model_mode_names,
};
```

## src/arbiter_model.h
```c
/* SPDX-License-Identifier: MIT */
/* AUTO-GENERATED by arbiterc — do not edit */

#pragma once

#include <stdint.h>
#include <stddef.h>
#include <arbiter/arbiter_model.h>

#define ARBITER_MODEL_NAME "embedded_firewall"
#define ARBITER_MODEL_HASH "9978239acdbec9ad1cb138b5c9ebe027c80a74e3258d7beacce1064093375aba"
#define ARBITER_MODEL_FACT_COUNT 13u
#define ARBITER_MODEL_RULE_COUNT 11u
#define ARBITER_MODEL_CONDITION_COUNT 16u
#define ARBITER_MODEL_ACTION_COUNT 3u
#define ARBITER_MODEL_MAX_FACTS 13u
#define ARBITER_MODEL_MAX_RULES 11u
#define ARBITER_MODEL_MAX_CONDITIONS 16u
#define ARBITER_MODEL_MAX_ACTIONS 3u
#define ARBITER_MODEL_WCET_OP_COUNT 27u
#define ARBITER_MODEL_TRACE_CAPACITY 11u

extern const struct ARBITER_model ARBITER_generated_model;

#define ARBITER_FACT_FW_ACTION 0u
#define ARBITER_FACT_FW_ICMP_RATE 1u
#define ARBITER_FACT_FW_IS_DNS 2u
#define ARBITER_FACT_FW_IS_SYN 3u
#define ARBITER_FACT_FW_PAYLOAD_ANOMALY 4u
#define ARBITER_FACT_FW_SRC_ON_ALLOWLIST 5u
#define ARBITER_FACT_FW_SRC_ON_BLOCKLIST 6u
#define ARBITER_FACT_FW_SYN_FLOOD_SCORE 7u
#define ARBITER_FACT_NET_DST_PORT 8u
#define ARBITER_FACT_NET_IS_ESTABLISHED 9u
#define ARBITER_FACT_NET_PACKET_LEN 10u
#define ARBITER_FACT_NET_PROTOCOL 11u
#define ARBITER_FACT_NET_RATE_PPS 12u

#define ARBITER_MODE_MODE_LOCKDOWN 0u
#define ARBITER_MODE_MODE_NORMAL 1u
#define ARBITER_MODE_MODE_RATE_LIMITED 2u
#define ARBITER_MODE_MODE_UNDER_ATTACK 3u
```
