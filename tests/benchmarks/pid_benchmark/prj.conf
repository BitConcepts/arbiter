## CMakeLists.txt
```
# SPDX-License-Identifier: MIT

cmake_minimum_required(VERSION 3.20.0)
find_package(Zephyr REQUIRED HINTS $ENV{ZEPHYR_BASE})
project(pid_benchmark)

target_sources(app PRIVATE src/main.c src/arbiter_model.c)
```

## prj.conf
```kconfig
CONFIG_ARBITER=y
CONFIG_TIMING_FUNCTIONS=y
CONFIG_LOG=y
CONFIG_PRINTK=y
CONFIG_MAIN_STACK_SIZE=4096
CONFIG_NATIVE_SIM_SLOWDOWN_TO_REAL_TIME=y
```

## src/main.c
```c
/* SPDX-License-Identifier: MIT */

/**
 * PID Benchmark: arbiter engine vs. hand-coded PID
 *
 * Measures:
 *   - CPU cycles per evaluation tick (avg over N iterations)
 *   - Peak stack usage (via k_thread_stack_space_get where available)
 *   - Static RAM footprint (struct sizes)
 *
 * ROM comparison is done post-build via `size` on the .elf — see README.
 *
 * Expected outcome:  Hand-coded PID is faster and smaller.  arbiter adds
 * ~2-5x cycle overhead and extra ROM/RAM for the engine tables, but
 * provides declarative safety semantics, traceability, model hashing,
 * and deterministic evaluation that hand-coded C does not.
 */

#include <zephyr/kernel.h>
#include <zephyr/logging/log.h>
#include <arbiter/arbiter.h>
#include "arbiter_model.h"

struct bench_ts { long tv_sec; long tv_nsec; };
extern int clock_gettime(int, struct bench_ts *);

static inline uint64_t bench_ns(void)
{
	struct bench_ts ts;

	clock_gettime(4 /* CLOCK_MONOTONIC_RAW */, &ts);
	return (uint64_t)(unsigned long)ts.tv_sec * 1000000000ULL +
		(uint64_t)(unsigned long)ts.tv_nsec;
}

LOG_MODULE_REGISTER(pid_bench, LOG_LEVEL_INF);

/* ------------------------------------------------------------------ */
/*  Hand-coded PID (baseline)                                         */
/* ------------------------------------------------------------------ */

struct hand_pid {
	int32_t kp;          /* x1000 */
	int32_t ki;          /* x1000 */
	int32_t kd;          /* x1000 */
	int32_t error_prev;
	int32_t i_term;
	int32_t output;
};

static void hand_pid_init(struct hand_pid *p)
{
	p->kp = 2500;
	p->ki = 100;
	p->kd = 800;
	p->error_prev = 0;
	p->i_term = 0;
	p->output = 0;
}

static void hand_pid_tick(struct hand_pid *p, int32_t setpoint,
			  int32_t process_value)
{
	int32_t error = setpoint - process_value;
	int32_t p_term = (int32_t)(((int64_t)error * p->kp) / 1000);

	p->i_term += (int32_t)(((int64_t)error * p->ki) / 10000);

	int32_t d_raw = error - p->error_prev;
	int32_t d_term = (int32_t)(((int64_t)d_raw * p->kd) / 1000);

	int32_t raw = p_term + p->i_term + d_term;

	/* Clamp */
	if (raw > 1000) {
		raw = 1000;
	} else if (raw < -1000) {
		raw = -1000;
	}

	/* Anti-windup */
	if (raw >= 1000 || raw <= -1000) {
		if (p->i_term > 500000) {
			p->i_term = 500000;
		} else if (p->i_term < -500000) {
			p->i_term = -500000;
		}
	}

	p->output = raw;
	p->error_prev = error;
}

/* ------------------------------------------------------------------ */
/*  arbiter PID (engine-based)                                          */
/* ------------------------------------------------------------------ */

/* Fact indices from generated header — canonical alphabetical order. */
#define F_KD           ARBITER_FACT_GAIN_KD
#define F_KI           ARBITER_FACT_GAIN_KI
#define F_KP           ARBITER_FACT_GAIN_KP
#define F_DT_MS        ARBITER_FACT_IN_DT_MS
#define F_ENABLE       ARBITER_FACT_IN_ENABLE
#define F_PROCESS_VALUE ARBITER_FACT_IN_PROCESS_VALUE
#define F_SENSOR_VALID ARBITER_FACT_IN_SENSOR_VALID
#define F_SETPOINT     ARBITER_FACT_IN_SETPOINT
#define F_ABS_ERROR    ARBITER_FACT_PID_ABS_ERROR
#define F_D_TERM       ARBITER_FACT_PID_D_TERM
#define F_ERROR        ARBITER_FACT_PID_ERROR
#define F_ERROR_PREV   ARBITER_FACT_PID_ERROR_PREV
#define F_I_TERM       ARBITER_FACT_PID_I_TERM
#define F_OUTPUT       ARBITER_FACT_PID_OUTPUT
#define F_OUTPUT_RAW   ARBITER_FACT_PID_OUTPUT_RAW
#define F_P_TERM       ARBITER_FACT_PID_P_TERM

static struct ARBITER_ctx ARBITER_ctx;

void app_update_actuator(void)
{
	/* No-op for benchmark — just reads output */
}

/* ------------------------------------------------------------------ */
/*  Benchmark harness                                                 */
/* ------------------------------------------------------------------ */

/* Increase iterations so native_sim (1 MHz timing clock) yields non-zero
 * nanosecond counts.
 */
#define BENCH_ITERATIONS  100000
#define WARMUP_ITERATIONS 1000

int main(void)
{
	LOG_INF("=== arbiter PID Benchmark ===");
	LOG_INF("Iterations: %d  (warmup: %d)", BENCH_ITERATIONS,
		WARMUP_ITERATIONS);

	/* ----- Hand-coded PID benchmark ----- */
	struct hand_pid hpid;

	hand_pid_init(&hpid);

	int32_t plant_h = 0;

	/* Warmup */
	for (int i = 0; i < WARMUP_ITERATIONS; i++) {
		hand_pid_tick(&hpid, 10000, plant_h);
		plant_h += hpid.output / 10;
	}

	hand_pid_init(&hpid);
	plant_h = 0;

	uint64_t t0_ns = bench_ns();

	for (int i = 0; i < BENCH_ITERATIONS; i++) {
		hand_pid_tick(&hpid, 10000, plant_h);
		plant_h += hpid.output / 10;
	}

	uint64_t t1_ns = bench_ns();
	uint64_t hand_ns = t1_ns - t0_ns;
	uint64_t hand_per_tick_ns = hand_ns / BENCH_ITERATIONS;

	LOG_INF("--- Hand-coded PID ---");
	LOG_INF("  Total: %llu ns  (%llu ns/tick)", hand_ns, hand_per_tick_ns);
	LOG_INF("  RAM (struct): %u bytes", (unsigned)sizeof(struct hand_pid));

	/* ----- arbiter engine PID benchmark ----- */
	int ret = ARBITER_init(&ARBITER_ctx, &ARBITER_generated_model);

	if (ret != ARBITER_OK) {
		LOG_ERR("arbiter init failed: %d", ret);
		return ret;
	}

	ARBITER_set_i32(&ARBITER_ctx, F_KP, 2500);
	ARBITER_set_i32(&ARBITER_ctx, F_KI, 100);
	ARBITER_set_i32(&ARBITER_ctx, F_KD, 800);
	ARBITER_set_bool(&ARBITER_ctx, F_ENABLE, true);
	ARBITER_set_bool(&ARBITER_ctx, F_SENSOR_VALID, true);
	ARBITER_set_u32(&ARBITER_ctx, F_DT_MS, 10);

	int32_t plant_z = 0;

	/* Warmup */
	for (int i = 0; i < WARMUP_ITERATIONS; i++) {
		ARBITER_set_i32(&ARBITER_ctx, F_SETPOINT, 10000);
		ARBITER_set_i32(&ARBITER_ctx, F_PROCESS_VALUE, plant_z);
		ARBITER_set_timestamp(&ARBITER_ctx, F_PROCESS_VALUE,
				    (uint32_t)i * 10);

		struct ARBITER_snapshot snap;
		struct ARBITER_result result;

		ARBITER_snapshot_begin(&ARBITER_ctx, &snap);
		ARBITER_eval(&ARBITER_generated_model, &snap, &result, NULL);
		plant_z += ARBITER_ctx.fact_values[F_OUTPUT].value / 10;
	}

	/* Reset for measurement */
	ARBITER_init(&ARBITER_ctx, &ARBITER_generated_model);
	ARBITER_set_i32(&ARBITER_ctx, F_KP, 2500);
	ARBITER_set_i32(&ARBITER_ctx, F_KI, 100);
	ARBITER_set_i32(&ARBITER_ctx, F_KD, 800);
	ARBITER_set_bool(&ARBITER_ctx, F_ENABLE, true);
	ARBITER_set_bool(&ARBITER_ctx, F_SENSOR_VALID, true);
	ARBITER_set_u32(&ARBITER_ctx, F_DT_MS, 10);
	plant_z = 0;

	uint64_t t2_ns = bench_ns();

	for (int i = 0; i < BENCH_ITERATIONS; i++) {
		ARBITER_set_i32(&ARBITER_ctx, F_SETPOINT, 10000);
		ARBITER_set_i32(&ARBITER_ctx, F_PROCESS_VALUE, plant_z);
		ARBITER_set_timestamp(&ARBITER_ctx, F_PROCESS_VALUE,
				    (uint32_t)(WARMUP_ITERATIONS + i) * 10);

		struct ARBITER_snapshot snap;
		struct ARBITER_result result;

		ARBITER_snapshot_begin(&ARBITER_ctx, &snap);
		ARBITER_eval(&ARBITER_generated_model, &snap, &result, NULL);
		plant_z += ARBITER_ctx.fact_values[F_OUTPUT].value / 10;
	}

	uint64_t t3_ns = bench_ns();
	uint64_t ARBITER_ns = t3_ns - t2_ns;
	uint64_t ARBITER_per_tick_ns = ARBITER_ns / BENCH_ITERATIONS;

	LOG_INF("--- arbiter Engine PID ---");
	LOG_INF("  Total: %llu ns  (%llu ns/tick)", ARBITER_ns,
		ARBITER_per_tick_ns);
	LOG_INF("  RAM (ctx): %u bytes", (unsigned)sizeof(struct ARBITER_ctx));
	LOG_INF("  Model tables: %u facts, %u rules, %u conditions, "
		"%u expressions",
		ARBITER_generated_model.fact_count,
		ARBITER_generated_model.rule_count,
		ARBITER_generated_model.condition_count,
		ARBITER_generated_model.expr_count);

	/* ----- Comparison ----- */
	LOG_INF("=== Comparison ===");

	uint64_t overhead_pct = 0;

	if (hand_per_tick_ns > 0) {
		overhead_pct = ((ARBITER_per_tick_ns - hand_per_tick_ns) * 100)
			       / hand_per_tick_ns;
	}

	LOG_INF("  Engine overhead: %llu%% (%llu vs %llu ns/tick)",
		overhead_pct, ARBITER_per_tick_ns, hand_per_tick_ns);
	LOG_INF("  RAM overhead: %u bytes (ctx) vs %u bytes (struct)",
		(unsigned)sizeof(struct ARBITER_ctx),
		(unsigned)sizeof(struct hand_pid));
	LOG_INF("  ROM: compare with `size build/zephyr/zephyr.elf`");
	LOG_INF("");
	LOG_INF("  arbiter adds: declarative model, safety guards,");
	LOG_INF("    traceability, model hashing, deterministic eval,");
	LOG_INF("    shell inspection, and runtime watchdog integration.");
	LOG_INF("  Hand-coded adds: nothing — it's just math.");

	/* timing_stop() not needed — using k_uptime, not timing API */

	return 0;
}
```

## src/arbiter_model.c
```c
/* SPDX-License-Identifier: MIT */
/* AUTO-GENERATED by arbiterc — do not edit */

#include "arbiter_model.h"
#include <arbiter/arbiter.h>

static const struct ARBITER_fact_def model_facts[] = {
	{ .id = 0, .type = ARBITER_FACT_INT32, .range_min = 0, .range_max = 100000, .default_value = 800, .stale_after_ms = 0, .safety_relevant = false, .name = "gain.kd" },
	{ .id = 1, .type = ARBITER_FACT_INT32, .range_min = 0, .range_max = 100000, .default_value = 100, .stale_after_ms = 0, .safety_relevant = false, .name = "gain.ki" },
	{ .id = 2, .type = ARBITER_FACT_INT32, .range_min = 0, .range_max = 100000, .default_value = 2500, .stale_after_ms = 0, .safety_relevant = false, .name = "gain.kp" },
	{ .id = 3, .type = ARBITER_FACT_UINT32, .range_min = 1, .range_max = 1000, .default_value = 0, .stale_after_ms = 0, .safety_relevant = false, .name = "in.dt_ms" },
	{ .id = 4, .type = ARBITER_FACT_BOOL, .range_min = 0, .range_max = 0, .default_value = 0, .stale_after_ms = 0, .safety_relevant = false, .name = "in.enable" },
	{ .id = 5, .type = ARBITER_FACT_INT32, .range_min = -180000, .range_max = 180000, .default_value = 0, .stale_after_ms = 50, .safety_relevant = true, .name = "in.process_value" },
	{ .id = 6, .type = ARBITER_FACT_BOOL, .range_min = 0, .range_max = 0, .default_value = 0, .stale_after_ms = 0, .safety_relevant = true, .name = "in.sensor_valid" },
	{ .id = 7, .type = ARBITER_FACT_INT32, .range_min = -180000, .range_max = 180000, .default_value = 0, .stale_after_ms = 200, .safety_relevant = false, .name = "in.setpoint" },
	{ .id = 8, .type = ARBITER_FACT_UINT32, .range_min = 0, .range_max = 360000, .default_value = 0, .stale_after_ms = 0, .safety_relevant = true, .name = "pid.abs_error" },
	{ .id = 9, .type = ARBITER_FACT_INT32, .range_min = 0, .range_max = 0, .default_value = 0, .stale_after_ms = 0, .safety_relevant = false, .name = "pid.d_term" },
	{ .id = 10, .type = ARBITER_FACT_INT32, .range_min = -360000, .range_max = 360000, .default_value = 0, .stale_after_ms = 0, .safety_relevant = false, .name = "pid.error" },
	{ .id = 11, .type = ARBITER_FACT_INT32, .range_min = 0, .range_max = 0, .default_value = 0, .stale_after_ms = 0, .safety_relevant = false, .name = "pid.error_prev" },
	{ .id = 12, .type = ARBITER_FACT_INT32, .range_min = 0, .range_max = 0, .default_value = 0, .stale_after_ms = 0, .safety_relevant = false, .name = "pid.i_term" },
	{ .id = 13, .type = ARBITER_FACT_INT32, .range_min = -1000, .range_max = 1000, .default_value = 0, .stale_after_ms = 0, .safety_relevant = true, .name = "pid.output" },
	{ .id = 14, .type = ARBITER_FACT_INT32, .range_min = 0, .range_max = 0, .default_value = 0, .stale_after_ms = 0, .safety_relevant = false, .name = "pid.output_raw" },
	{ .id = 15, .type = ARBITER_FACT_INT32, .range_min = 0, .range_max = 0, .default_value = 0, .stale_after_ms = 0, .safety_relevant = false, .name = "pid.p_term" },
};

static const struct ARBITER_condition_def model_conditions[] = {
	{ .fact_id = 6, .op = ARBITER_OP_EQ, .value = 0, .group = ARBITER_COND_ANY, .group_index = 0, .next = UINT16_MAX },
	{ .fact_id = 5, .op = ARBITER_OP_STALE, .value = 50, .group = ARBITER_COND_ANY, .group_index = 0, .next = UINT16_MAX },
	{ .fact_id = 8, .op = ARBITER_OP_GT, .value = 30000, .group = ARBITER_COND_ALL, .group_index = 0, .next = UINT16_MAX },
	{ .fact_id = 4, .op = ARBITER_OP_EQ, .value = 1, .group = ARBITER_COND_ALL, .group_index = 0, .next = UINT16_MAX },
	{ .fact_id = 4, .op = ARBITER_OP_EQ, .value = 0, .group = ARBITER_COND_ALL, .group_index = 0, .next = UINT16_MAX },
	{ .fact_id = 4, .op = ARBITER_OP_EQ, .value = 1, .group = ARBITER_COND_ALL, .group_index = 0, .next = UINT16_MAX },
	{ .fact_id = 6, .op = ARBITER_OP_EQ, .value = 1, .group = ARBITER_COND_ALL, .group_index = 0, .next = UINT16_MAX },
	{ .fact_id = 4, .op = ARBITER_OP_EQ, .value = 1, .group = ARBITER_COND_ALL, .group_index = 0, .next = UINT16_MAX },
	{ .fact_id = 6, .op = ARBITER_OP_EQ, .value = 1, .group = ARBITER_COND_ALL, .group_index = 0, .next = UINT16_MAX },
	{ .fact_id = 14, .op = ARBITER_OP_GT, .value = 1000, .group = ARBITER_COND_ALL, .group_index = 0, .next = UINT16_MAX },
	{ .fact_id = 14, .op = ARBITER_OP_LT, .value = -1000, .group = ARBITER_COND_ALL, .group_index = 0, .next = UINT16_MAX },
	{ .fact_id = 4, .op = ARBITER_OP_EQ, .value = 1, .group = ARBITER_COND_ALL, .group_index = 0, .next = UINT16_MAX },
};

static const struct ARBITER_action_def model_actions[] = {
	{ .id = 0, .type = ARBITER_ACTION_CALLBACK, .target_fact_id = 0, .target_value = 0, .callback = NULL, .must_complete_within_ms = 0, .safe_state_action = false, .name = "update_actuator" },
};

static const struct ARBITER_rule_def model_rules[] = {
	{ .id = 0, .rule_class = ARBITER_RULE_SAFETY_GUARD, .condition_start = 0, .condition_count = 2, .action_start = 0, .action_count = 1, .expr_start = 0, .expr_count = 2, .safety_goal_id = UINT16_MAX, .set_mode = 4, .safety_critical = true, .name = "01_fault.sensor", .explanation = "Sensor fault — zero output." },
	{ .id = 1, .rule_class = ARBITER_RULE_SAFETY_GUARD, .condition_start = 2, .condition_count = 2, .action_start = 0, .action_count = 1, .expr_start = 2, .expr_count = 2, .safety_goal_id = UINT16_MAX, .set_mode = 2, .safety_critical = true, .name = "02_fault.following", .explanation = "Following error > 30 deg — fault." },
	{ .id = 2, .rule_class = ARBITER_RULE_MODE_GUARD, .condition_start = 4, .condition_count = 1, .action_start = 0, .action_count = 0, .expr_start = 4, .expr_count = 2, .safety_goal_id = UINT16_MAX, .set_mode = 1, .safety_critical = false, .name = "03_check.disabled", .explanation = NULL },
	{ .id = 3, .rule_class = ARBITER_RULE_INFERENCE, .condition_start = 5, .condition_count = 2, .action_start = 0, .action_count = 0, .expr_start = 6, .expr_count = 7, .safety_goal_id = UINT16_MAX, .set_mode = 3, .safety_critical = false, .name = "10_pid.compute", .explanation = "PID compute: error, P, I+=, D." },
	{ .id = 4, .rule_class = ARBITER_RULE_INFERENCE, .condition_start = 7, .condition_count = 2, .action_start = 0, .action_count = 0, .expr_start = 13, .expr_count = 3, .safety_goal_id = UINT16_MAX, .set_mode = UINT16_MAX, .safety_critical = false, .name = "20_pid.output", .explanation = NULL },
	{ .id = 5, .rule_class = ARBITER_RULE_MODE_GUARD, .condition_start = 9, .condition_count = 1, .action_start = 0, .action_count = 0, .expr_start = 16, .expr_count = 1, .safety_goal_id = UINT16_MAX, .set_mode = 0, .safety_critical = false, .name = "30_windup.pos", .explanation = "Output saturated — integral clamped." },
	{ .id = 6, .rule_class = ARBITER_RULE_MODE_GUARD, .condition_start = 10, .condition_count = 1, .action_start = 0, .action_count = 0, .expr_start = 17, .expr_count = 1, .safety_goal_id = UINT16_MAX, .set_mode = 0, .safety_critical = false, .name = "31_windup.neg", .explanation = NULL },
	{ .id = 7, .rule_class = ARBITER_RULE_OBLIGATION, .condition_start = 11, .condition_count = 1, .action_start = 0, .action_count = 1, .expr_start = 18, .expr_count = 0, .safety_goal_id = UINT16_MAX, .set_mode = UINT16_MAX, .safety_critical = false, .name = "40_actuate", .explanation = "Write pid.output to actuator." },
};

static const struct ARBITER_expr_def model_expressions[] = {
	{ .target_fact_id = 13, .op = ARBITER_EXPR_ASSIGN, .left_fact_id = 65535, .left_literal = 0, .right_fact_id = 65535, .right_literal = 0, .scale = 1 },
	{ .target_fact_id = 12, .op = ARBITER_EXPR_ASSIGN, .left_fact_id = 65535, .left_literal = 0, .right_fact_id = 65535, .right_literal = 0, .scale = 1 },
	{ .target_fact_id = 13, .op = ARBITER_EXPR_ASSIGN, .left_fact_id = 65535, .left_literal = 0, .right_fact_id = 65535, .right_literal = 0, .scale = 1 },
	{ .target_fact_id = 12, .op = ARBITER_EXPR_ASSIGN, .left_fact_id = 65535, .left_literal = 0, .right_fact_id = 65535, .right_literal = 0, .scale = 1 },
	{ .target_fact_id = 13, .op = ARBITER_EXPR_ASSIGN, .left_fact_id = 65535, .left_literal = 0, .right_fact_id = 65535, .right_literal = 0, .scale = 1 },
	{ .target_fact_id = 12, .op = ARBITER_EXPR_ASSIGN, .left_fact_id = 65535, .left_literal = 0, .right_fact_id = 65535, .right_literal = 0, .scale = 1 },
	{ .target_fact_id = 11, .op = ARBITER_EXPR_ASSIGN, .left_fact_id = 10, .left_literal = 0, .right_fact_id = 65535, .right_literal = 0, .scale = 1 },
	{ .target_fact_id = 10, .op = ARBITER_EXPR_SUB, .left_fact_id = 7, .left_literal = 0, .right_fact_id = 5, .right_literal = 0, .scale = 1 },
	{ .target_fact_id = 8, .op = ARBITER_EXPR_ABS, .left_fact_id = 10, .left_literal = 0, .right_fact_id = 65535, .right_literal = 0, .scale = 1 },
	{ .target_fact_id = 15, .op = ARBITER_EXPR_SCALE, .left_fact_id = 10, .left_literal = 0, .right_fact_id = 2, .right_literal = 0, .scale = 1000 },
	{ .target_fact_id = 12, .op = ARBITER_EXPR_ACCUMULATE, .left_fact_id = 10, .left_literal = 0, .right_fact_id = 1, .right_literal = 0, .scale = 10000 },
	{ .target_fact_id = 9, .op = ARBITER_EXPR_SUB, .left_fact_id = 10, .left_literal = 0, .right_fact_id = 11, .right_literal = 0, .scale = 1 },
	{ .target_fact_id = 9, .op = ARBITER_EXPR_SCALE, .left_fact_id = 9, .left_literal = 0, .right_fact_id = 0, .right_literal = 0, .scale = 1000 },
	{ .target_fact_id = 14, .op = ARBITER_EXPR_ADD, .left_fact_id = 15, .left_literal = 0, .right_fact_id = 12, .right_literal = 0, .scale = 1 },
	{ .target_fact_id = 14, .op = ARBITER_EXPR_ADD, .left_fact_id = 14, .left_literal = 0, .right_fact_id = 9, .right_literal = 0, .scale = 1 },
	{ .target_fact_id = 13, .op = ARBITER_EXPR_CLAMP, .left_fact_id = 14, .left_literal = 0, .right_fact_id = 65535, .right_literal = -1000, .scale = 1000 },
	{ .target_fact_id = 12, .op = ARBITER_EXPR_CLAMP, .left_fact_id = 12, .left_literal = 0, .right_fact_id = 65535, .right_literal = -500000, .scale = 500000 },
	{ .target_fact_id = 12, .op = ARBITER_EXPR_CLAMP, .left_fact_id = 12, .left_literal = 0, .right_fact_id = 65535, .right_literal = -500000, .scale = 500000 },
};

static const char *model_mode_names[] = {
	"mode.anti_windup",
	"mode.disabled",
	"mode.following_fault",
	"mode.running",
	"mode.sensor_fault",
};

const struct ARBITER_model ARBITER_generated_model = {
	.name = "pid_engine",
	.model_hash = { 0xc2, 0x13, 0x66, 0x7b, 0xc6, 0xdd, 0xaa, 0xb4, 0xe6, 0x94, 0x58, 0x36, 0xd5, 0xcd, 0x49, 0xce, 0x6c, 0x7e, 0x48, 0xd7, 0x8d, 0x08, 0x23, 0x33, 0x4e, 0x76, 0x51, 0x89, 0xb5, 0xcc, 0x65, 0xa2 },
	.schema_hash = { 0x0d, 0x55, 0x33, 0x65, 0xf3, 0x4e, 0x02, 0xf3, 0xf8, 0x94, 0xe8, 0x25, 0xbb, 0x47, 0x86, 0x45, 0xfd, 0x8b, 0x78, 0xb1, 0x27, 0xf5, 0x8c, 0x42, 0xba, 0xbd, 0x80, 0x1f, 0x77, 0x57, 0x1f, 0x35 },
	.fact_count = 16,
	.rule_count = 8,
	.condition_count = 12,
	.action_count = 1,
	.expr_count = 18,
	.mode_count = 5,
	.facts = model_facts,
	.rules = model_rules,
	.conditions = model_conditions,
	.actions = model_actions,
	.expressions = model_expressions,
	.mode_names = model_mode_names,
};
```

## src/arbiter_model.h
```c
/* SPDX-License-Identifier: MIT */
/* AUTO-GENERATED by arbiterc — do not edit */

#pragma once

#include <stdint.h>
#include <stddef.h>
#include <arbiter/arbiter_model.h>

#define ARBITER_MODEL_NAME "pid_engine"
#define ARBITER_MODEL_HASH "c213667bc6ddaab4e6945836d5cd49ce6c7e48d78d0823334e765189b5cc65a2"
#define ARBITER_MODEL_FACT_COUNT 16u
#define ARBITER_MODEL_RULE_COUNT 8u
#define ARBITER_MODEL_CONDITION_COUNT 12u
#define ARBITER_MODEL_ACTION_COUNT 1u
#define ARBITER_MODEL_MAX_FACTS 16u
#define ARBITER_MODEL_MAX_RULES 8u
#define ARBITER_MODEL_MAX_CONDITIONS 12u
#define ARBITER_MODEL_MAX_ACTIONS 1u
#define ARBITER_MODEL_WCET_OP_COUNT 20u
#define ARBITER_MODEL_TRACE_CAPACITY 8u

extern const struct ARBITER_model ARBITER_generated_model;

#define ARBITER_FACT_GAIN_KD 0u
#define ARBITER_FACT_GAIN_KI 1u
#define ARBITER_FACT_GAIN_KP 2u
#define ARBITER_FACT_IN_DT_MS 3u
#define ARBITER_FACT_IN_ENABLE 4u
#define ARBITER_FACT_IN_PROCESS_VALUE 5u
#define ARBITER_FACT_IN_SENSOR_VALID 6u
#define ARBITER_FACT_IN_SETPOINT 7u
#define ARBITER_FACT_PID_ABS_ERROR 8u
#define ARBITER_FACT_PID_D_TERM 9u
#define ARBITER_FACT_PID_ERROR 10u
#define ARBITER_FACT_PID_ERROR_PREV 11u
#define ARBITER_FACT_PID_I_TERM 12u
#define ARBITER_FACT_PID_OUTPUT 13u
#define ARBITER_FACT_PID_OUTPUT_RAW 14u
#define ARBITER_FACT_PID_P_TERM 15u

#define ARBITER_MODE_MODE_ANTI_WINDUP 0u
#define ARBITER_MODE_MODE_DISABLED 1u
#define ARBITER_MODE_MODE_FOLLOWING_FAULT 2u
#define ARBITER_MODE_MODE_RUNNING 3u
#define ARBITER_MODE_MODE_SENSOR_FAULT 4u
```
