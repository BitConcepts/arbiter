## samples/access_control/sample.yaml
```yaml
sample:
  name: arbiter Access Control & CORS
  description: >
    IoT gateway access policy with CORS origin validation, JWT auth,
    role-based path access, rate limiting, payload size checks, and
    computed risk scoring.
common:
  tags: arbiter reasoning cors auth security api iot
  platform_allow: native_sim
tests:
  sample.arbiter.access-control:
    tags: arbiter sample
    platform_allow: native_sim
    build_only: true
```

## samples/access_control/testcase.yaml
```yaml
tests:
  sample.arbiter.access-control:
    tags: arbiter sample
    platform_allow: native_sim
    harness: console
    build_only: true
```

## samples/battery_policy/sample.yaml
```yaml
sample:
  name: arbiter Battery Policy
  description: Demonstrates arbiter battery management policy evaluation.
common:
  tags: arbiter reasoning safety
  platform_allow: native_sim
tests:
  sample.arbiter.battery-policy:
    tags: arbiter sample
    platform_allow: native_sim
    build_only: true
```

## samples/battery_policy/testcase.yaml
```yaml
tests:
  sample.arbiter.battery-policy:
    tags: arbiter sample
    platform_allow: native_sim
    harness: console
    build_only: true
```

## samples/cobot_safety/sample.yaml
```yaml
sample:
  name: arbiter Cobot Safety Controller
  description: >
    Collaborative robot safety per ISO 10218 / TS 15066. Zone-based and
    proximity-based dynamic speed/force limiting, protective stop on
    close approach, overspeed/overtorque detection. Imports estop and
    safety_common includes.
common:
  tags: arbiter reasoning safety cobot robotics iso-10218
  harness: console
  platform_allow: native_sim
```

## samples/cobot_safety/testcase.yaml
```yaml
tests:
  sample.arbiter.cobot-safety:
    tags: arbiter sample
    platform_allow: native_sim
    harness: console
    build_only: true
```

## samples/fault_diagnosis/sample.yaml
```yaml
sample:
  name: arbiter Fault Diagnosis Solver
  description: >
    Root-cause fault diagnosis using weighted evidence accumulation.
    Maps observed symptom flags to candidate causes with confidence
    scoring.  Demonstrates a motor-drive diagnostic solver with
    6 symptom inputs and 4 candidate diagnoses.
common:
  tags: arbiter solver diagnostics fault-tree motor-drive
  harness: console
  platform_allow: native_sim
tests:
  sample.arbiter.fault-diagnosis:
    tags: arbiter sample solver
    platform_allow: native_sim
    harness: console
    build_only: true
```

## samples/fault_diagnosis/testcase.yaml
```yaml
tests:
  sample.arbiter.fault-diagnosis:
    tags: arbiter sample solver
    platform_allow: native_sim
    harness: console
    build_only: true
```

## samples/firewall_policy/testcase.yaml
```yaml
tests:
  sample.arbiter.firewall-policy:
    tags: arbiter sample
    platform_allow: native_sim
    harness: console
    build_only: true
```

## samples/firmware_guard/testcase.yaml
```yaml
tests:
  sample.arbiter.firmware-guard:
    tags: arbiter sample
    platform_allow: native_sim
    harness: console
    build_only: true
```

## samples/hvac_controller/sample.yaml
```yaml
sample:
  name: arbiter HVAC Zone Controller
  description: >
    Multi-zone climate reasoning. Computes heating/cooling demand from
    error, handles occupancy setback, window override, peak energy
    shedding, and dehumidification mode selection.
common:
  tags: arbiter reasoning compute hvac climate iot building
  platform_allow: native_sim
tests:
  sample.arbiter.hvac-controller:
    tags: arbiter sample
    platform_allow: native_sim
    build_only: true
```

## samples/hvac_controller/testcase.yaml
```yaml
tests:
  sample.arbiter.hvac-controller:
    tags: arbiter sample
    platform_allow: native_sim
    harness: console
    build_only: true
```

## samples/hydraulic_press/testcase.yaml
```yaml
tests:
  sample.arbiter.hydraulic-press:
    tags: arbiter sample
    platform_allow: native_sim
    harness: console
    build_only: true
```

## samples/kalman_filter/sample.yaml
```yaml
sample:
  name: arbiter Kalman Filter Solver
  description: >
    A 1-D Kalman filter implemented entirely in ARB compute expressions.
    Demonstrates predict/update cycle with fixed-point Kalman gain
    calculation, covariance tracking, and sensor fusion — a common
    numerical solver pattern for embedded navigation and estimation.
common:
  tags: arbiter solver kalman filter estimation sensor-fusion
  harness: console
  platform_allow: native_sim
tests:
  sample.arbiter.kalman-filter:
    tags: arbiter sample solver
    platform_allow: native_sim
    harness: console
    build_only: true
```

## samples/kalman_filter/testcase.yaml
```yaml
tests:
  sample.arbiter.kalman-filter:
    tags: arbiter sample solver
    platform_allow: native_sim
    harness: console
    build_only: true
```

## samples/mesh_router/sample.yaml
```yaml
sample:
  name: arbiter Mesh Network Router
  description: >
    Thread/OpenThread-inspired mesh routing reasoning engine. arbiter
    computes link margin, parent quality scores, and congestion levels,
    then reasons about parent selection, TX power, rate limiting, and
    power management. Demonstrates compute + reasoning, not just policy.
common:
  tags: arbiter reasoning compute mesh thread openthread routing
  platform_allow: native_sim
tests:
  sample.arbiter.mesh-router:
    tags: arbiter sample
    platform_allow: native_sim
    build_only: true
```

## samples/mesh_router/testcase.yaml
```yaml
tests:
  sample.arbiter.mesh-router:
    tags: arbiter sample
    platform_allow: native_sim
    harness: console
    build_only: true
```

## samples/motion_planner/sample.yaml
```yaml
sample:
  name: arbiter Motion Planner Solver
  description: >
    Waypoint trajectory planner with obstacle avoidance.  Computes
    steering corrections from position, target bearing, and obstacle
    proximity.  Includes safety-critical emergency stop when obstacles
    are too close — demonstrating motion planning as reasoning.
common:
  tags: arbiter solver motion-planning navigation obstacle-avoidance
  harness: console
  platform_allow: native_sim
tests:
  sample.arbiter.motion-planner:
    tags: arbiter sample solver
    platform_allow: native_sim
    harness: console
    build_only: true
```

## samples/motion_planner/testcase.yaml
```yaml
tests:
  sample.arbiter.motion-planner:
    tags: arbiter sample solver
    platform_allow: native_sim
    harness: console
    build_only: true
```

## samples/pid_controller/sample.yaml
```yaml
sample:
  name: arbiter PID Engine
  description: >
    arbiter IS the PID controller. The compute engine calculates error,
    P/I/D terms, output summing, clamping, and anti-windup — all in
    ARB rules with fixed-point arithmetic. The application only feeds
    setpoint + sensor values and provides an actuator callback.
common:
  tags: arbiter reasoning compute pid engine motion-control
  platform_allow: native_sim
tests:
  sample.arbiter.pid-controller:
    tags: arbiter sample
    platform_allow: native_sim
    build_only: true
```

## samples/pid_controller/testcase.yaml
```yaml
tests:
  sample.zproj.pid-controller:
    tags: zproj sample
    platform_allow: native_sim
    harness: console
    build_only: true
```

## samples/power_budget/sample.yaml
```yaml
sample:
  name: arbiter Power Budget Solver
  description: >
    Allocates a limited power budget across 4 subsystems using
    priority-based reasoning.  Sheds low-priority loads when demand
    exceeds supply and triggers brownout protection when battery
    is critical — a common embedded energy management pattern.
common:
  tags: arbiter solver power-management battery load-shedding
  harness: console
  platform_allow: native_sim
```

## samples/power_budget/testcase.yaml
```yaml
tests:
  sample.arbiter.power-budget:
    tags: arbiter sample solver
    platform_allow: native_sim
    harness: console
    build_only: true
```

## samples/power_mppt/sample.yaml
```yaml
sample:
  name: arbiter Solar MPPT Tracker
  description: >
    Perturb-and-Observe MPPT algorithm as a arbiter compute engine.
    Computes panel power, tracks power deltas, adjusts PWM duty cycle,
    handles night/overtemp/float-charge modes. Demonstrates compute-heavy
    reasoning with fixed-point arithmetic.
common:
  tags: arbiter reasoning compute mppt solar energy power
  harness: console
  platform_allow: native_sim
```
